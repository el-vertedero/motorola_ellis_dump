/dts-v1/;

/ {

	fragment@channel-id {
		target-path = "/";

		__overlay__ {
			channel-id-map = "acg\0amxbr\0amxpr\0amxmx\0amxcl\0amxar\0amxla\0amxpe\0amxco\0tefbr\0tefmx\0tefar\0tefcl\0tefpe\0tefco\0perar\0entcl\0iusmx\0niibr\0niicl\0niimx\0niipe\0oibr\0timbr\0tigco\0retbr\0retar\0retla\0retcl\0tefla\0retla1st\0tefunl\0tigca\0tigca1st\0retmx\0attmx\0womcl\0avaco\0retpe\0openla\0opencl\0openmx\0altmx\0openpe\0undefined\0undefined\0undefined\0undefined\0undefined\0undefined\0undefined\0undefined\0undefined\0undefined\0undefined\0undefined\0undefined\0undefined\0undefined\0undefined\0undefined\0undefined\0undefined\0undefined\0reteu\0retgb\0retfr\0retes\0retie\0retde\0vfgb\0vfde\0vffr\0o2gb\0o2de\0orafr\0bouyfr\0eegb\0tescogb\0yoigo\0oraes\0retapac\0retmea\0vfit\0vfes\0vfeu\03gb\0tescoie\0altfr\03ie\0altpt\0timit\0retma\0windit\0vfhu\0vfro\0telhu\0playpl\0oraeu\0dteu\0teleu\0pluspl\0dtpl\0tefes\0altice\0vipeu\0veoneu\0openeu\0reteu2\0undefined\0undefined\0undefined\0undefined\0undefined\0undefined\0undefined\0undefined\0undefined\0undefined\0undefined\0undefined\0undefined\0undefined\0undefined\0undefined\0undefined\0undefined\0undefined\0retca\0bwaca\0tkpca\0vzw\0att\0tmo\0sprint\0repw\0attpre\0cricket\0cc\0usc\0tracfone\0retus\0metropcs\0rcica\0wndca\0dmc\0bby\0amz\0acg\0lra\0comcast\0fi\0vzwpre\0boost\0spectrum\0undefined\0undefined\0undefined\0undefined\0undefined\0undefined\0undefined\0undefined\0undefined\0undefined\0undefined\0undefined\0undefined\0undefined\0undefined\0undefined\0undefined\0undefined\0undefined\0undefined\0undefined\0undefined\0undefined\0undefined\0undefined\0undefined\0undefined\0undefined\0undefined\0undefined\0undefined\0undefined\0undefined\0undefined\0undefined\0undefined\0undefined\0retin\0retcn\0telstra\0vfau\0amzin\0jioin\0airin\0retid\0cmcc\0ctcn\0cucn\0retmm\0gt4gtw\0retth\0retru\0trueth\0smarthk\0mobilpk\0retsea\0retjp\0softbank\0undefined\0undefined\0undefined\0undefined\0undefined\0undefined\0undefined\0undefined\0undefined\0undefined\0undefined\0undefined\0undefined\0undefined\0undefined\0undefined\0undefined\0undefined\0undefined\0undefined\0undefined\0undefined\0undefined\0undefined\0undefined\0undefined\0undefined\0undefined\0undefined\0undefined\0undefined\0undefined\0undefined\0undefined\0undefined\0undefined\0undefined\0undefined\0undefined\0undefined\0undefined\0undefined\0undefined";
		};
	};

	fragment@0 {
		target = <0xffffffff>;

		__overlay__ {

			utags {
				compatible = "mmi,utags";
				mmi,main-utags = "/dev/block/by-name/utags";
				mmi,backup-utags = "/dev/block/by-name/utagsBackup";
			};

			hw {
				compatible = "mmi,utags";
				mmi,dir-name = "hw";
				mmi,main-utags = "/dev/block/by-name/hw";
			};
		};
	};

	fragment@1 {
		target = <0xffffffff>;

		__overlay__ {
			temp_t4_threshold = <0x3c>;
		};
	};

	fragment@2 {
		target = <0xffffffff>;

		__overlay__ {
			status = "ok";

			abov_sar@20 {
				status = "ok";
				compatible = "abov,abov_sar_mmi_overlay_7ch";
				reg = <0x20>;
				cap_vdd-supply = <0xffffffff>;
				interrupt-parent = <0xffffffff>;
				interrupts = <0x01 0x02 0x01 0x00>;
				abov,irq-gpio-std = <0xffffffff 0x0c 0x00>;
				reg_array_len = <0x03>;
				reg_array_val = <0x07 0x00 0x08 0x1f 0xfb 0x01>;
				cap,use_channel_ch0 = <0x00>;
				cap,use_channel_ch1 = <0x01>;
				cap,use_channel_ch2 = <0x02>;
				ch0_name = "capsense_bottom";
				ch1_name = "capsense_top_left";
				ch2_name = "capsense_top_right";
				label = "AbovCapSense";
				cap,channel_number = <0x03>;
				cap,fw_mode_ret = <0x39>;
				button_mask = <0x15>;
				cap,flash_erase_time = <0x578>;
			};
		};
	};

	fragment@3 {
		target = <0xffffffff>;

		__overlay__ {

			camera_pins_cam0_mclk_on {
				phandle = <0x14>;

				pins_cmd_dat {
					pinmux = <0x6301>;
				};
			};

			camera_pins_cam0_mclk_off {
				phandle = <0x15>;

				pins_cmd_dat {
					pinmux = <0x6300>;
				};
			};

			camera_pins_cam1_mclk_on {
				phandle = <0x16>;

				pins_cmd_dat {
					pinmux = <0x6401>;
				};
			};

			camera_pins_cam1_mclk_off {
				phandle = <0x17>;

				pins_cmd_dat {
					pinmux = <0x6400>;
				};
			};

			camera_pins_cam2_mclk_on {
				phandle = <0x18>;

				pins_cmd_dat {
					pinmux = <0x6c01>;
				};
			};

			camera_pins_cam2_mclk_off {
				phandle = <0x19>;

				pins_cmd_dat {
					pinmux = <0x6c00>;
				};
			};

			cam0@0 {
				phandle = <0x02>;

				pins_cmd_dat {
					pinmux = <0x6500>;
					slew-rate = <0x01>;
					output-low;
				};
			};

			cam0@1 {
				phandle = <0x03>;

				pins_cmd_dat {
					pinmux = <0x6500>;
					slew-rate = <0x01>;
					output-high;
				};
			};

			cam0@2 {
				phandle = <0x04>;

				pins_cmd_dat {
					pinmux = <0x6100>;
					slew-rate = <0x01>;
					output-low;
				};
			};

			cam0@3 {
				phandle = <0x05>;

				pins_cmd_dat {
					pinmux = <0x6100>;
					slew-rate = <0x01>;
					output-high;
				};
			};

			cam1@0 {
				phandle = <0x06>;

				pins_cmd_dat {
					pinmux = <0x6600>;
					slew-rate = <0x01>;
					output-low;
				};
			};

			cam1@1 {
				phandle = <0x07>;

				pins_cmd_dat {
					pinmux = <0x6600>;
					slew-rate = <0x01>;
					output-high;
				};
			};

			cam1@2 {
				phandle = <0x08>;

				pins_cmd_dat {
					pinmux = <0x6200>;
					slew-rate = <0x01>;
					output-low;
				};
			};

			cam1@3 {
				phandle = <0x09>;

				pins_cmd_dat {
					pinmux = <0x6200>;
					slew-rate = <0x01>;
					output-high;
				};
			};

			cam2@0 {
				phandle = <0x0a>;

				pins_cmd_dat {
					pinmux = <0x6d00>;
					slew-rate = <0x01>;
					output-low;
				};
			};

			cam2@1 {
				phandle = <0x0b>;

				pins_cmd_dat {
					pinmux = <0x6d00>;
					slew-rate = <0x01>;
					output-high;
				};
			};

			cam2@2 {
				phandle = <0x0c>;

				pins_cmd_dat {
					pinmux = <0xa000>;
					slew-rate = <0x01>;
					output-low;
				};
			};

			cam2@3 {
				phandle = <0x0d>;

				pins_cmd_dat {
					pinmux = <0xa000>;
					slew-rate = <0x01>;
					output-high;
				};
			};

			cam0@vcama0 {
				phandle = <0x0f>;

				pins_cmd_dat {
					pinmux = <0x5c00>;
					slew-rate = <0x01>;
					output-low;
				};
			};

			cam0@vcama1 {
				phandle = <0x0e>;

				pins_cmd_dat {
					pinmux = <0x5c00>;
					slew-rate = <0x01>;
					output-high;
				};
			};

			cam1@vcama0 {
				phandle = <0x11>;

				pins_cmd_dat {
					pinmux = <0x5c00>;
					slew-rate = <0x01>;
					output-low;
				};
			};

			cam1@vcama1 {
				phandle = <0x10>;

				pins_cmd_dat {
					pinmux = <0x5c00>;
					slew-rate = <0x01>;
					output-high;
				};
			};

			cam2@vcama0 {
				phandle = <0x13>;

				pins_cmd_dat {
					pinmux = <0x9f00>;
					slew-rate = <0x01>;
					output-low;
				};
			};

			cam2@vcama1 {
				phandle = <0x12>;

				pins_cmd_dat {
					pinmux = <0x9f00>;
					slew-rate = <0x01>;
					output-high;
				};
			};

			camdefault {
				phandle = <0x01>;
			};
		};
	};

	fragment@4 {
		target = <0xffffffff>;

		__overlay__ {
			pinctrl-names = "default\0cam0_rst0\0cam0_rst1\0cam0_pnd0\0cam0_pnd1\0cam1_rst0\0cam1_rst1\0cam1_pnd0\0cam1_pnd1\0cam2_rst0\0cam2_rst1\0cam2_pnd0\0cam2_pnd1\0cam0_vcama_on\0cam0_vcama_off\0cam1_vcama_on\0cam1_vcama_off\0cam2_vcama_on\0cam2_vcama_off\0cam0_mclk_on\0cam0_mclk_off\0cam1_mclk_on\0cam1_mclk_off\0cam2_mclk_on\0cam2_mclk_off";
			pinctrl-0 = <0x01>;
			pinctrl-1 = <0x02>;
			pinctrl-2 = <0x03>;
			pinctrl-3 = <0x04>;
			pinctrl-4 = <0x05>;
			pinctrl-5 = <0x06>;
			pinctrl-6 = <0x07>;
			pinctrl-7 = <0x08>;
			pinctrl-8 = <0x09>;
			pinctrl-9 = <0x0a>;
			pinctrl-10 = <0x0b>;
			pinctrl-11 = <0x0c>;
			pinctrl-12 = <0x0d>;
			pinctrl-13 = <0x0e>;
			pinctrl-14 = <0x0f>;
			pinctrl-15 = <0x10>;
			pinctrl-16 = <0x11>;
			pinctrl-17 = <0x12>;
			pinctrl-18 = <0x13>;
			pinctrl-19 = <0x14>;
			pinctrl-20 = <0x15>;
			pinctrl-21 = <0x16>;
			pinctrl-22 = <0x17>;
			pinctrl-23 = <0x18>;
			pinctrl-24 = <0x19>;
			cam0_vcamio-supply = <0xffffffff>;
			cam0_vcamd-supply = <0xffffffff>;
			cam1_vcamd-supply = <0xffffffff>;
			cam1_vcamio-supply = <0xffffffff>;
			cam2_vcama-supply = <0xffffffff>;
			cam2_vcamio-supply = <0xffffffff>;
			cam0_enable_sensor = "mot_ellis_hi1336_mipi_raw";
			cam1_enable_sensor = "mot_ellis_sc500cs_mipi_raw mot_ellis_hi556d_mipi_raw";
			cam2_enable_sensor = "mot_ellis_ov02b1b_mipi_raw mot_ellis_gc02m1b_mipi_raw";
			status = "okay";
		};
	};

	fragment@5 {
		target = <0xffffffff>;

		__overlay__ {

			flash_default_cfg {
				phandle = <0x1a>;
			};

			flash_en_pin0 {
				phandle = <0x1b>;

				pins_cmd_dat {
					pinmux = <0xad00>;
					slew-rate = <0x01>;
					output-low;
				};
			};

			flash_en_pin1 {
				phandle = <0x1c>;

				pins_cmd_dat {
					pinmux = <0xad00>;
					slew-rate = <0x01>;
					output-high;
				};
			};

			torch_en_pin0 {
				phandle = <0x1d>;

				pins_cmd_dat {
					pinmux = <0x9a00>;
					slew-rate = <0x01>;
					output-low;
				};
			};

			torch_en_pin1 {
				phandle = <0x1e>;

				pins_cmd_dat {
					pinmux = <0x9a00>;
					slew-rate = <0x01>;
					output-high;
				};
			};
		};
	};

	fragment@6 {
		target = <0xffffffff>;

		__overlay__ {
			pinctrl-names = "flash_default\0flash_en_pin0\0flash_en_pin1\0torch_en_pin0\0torch_en_pin1";
			pinctrl-0 = <0x1a>;
			pinctrl-1 = <0x1b>;
			pinctrl-2 = <0x1c>;
			pinctrl-3 = <0x1d>;
			pinctrl-4 = <0x1e>;
			status = "okay";
		};
	};

	fragment@7 {
		target = <0xffffffff>;

		__overlay__ {
			camaf_m1_pmic-supply = <0xffffffff>;
			status = "okay";
		};
	};

	fragment@8 {
		target = <0xffffffff>;

		__overlay__ {
			tpd-resolution = <0x2d0 0x640>;
			use-tpd-button = <0x00>;
			tpd-key-num = <0x03>;
			tpd-key-local = <0x8b 0xac 0x9e 0x00>;
			tpd-key-dim-local = <0x5a 0x373 0x64 0x28 0xe6 0x373 0x64 0x28 0x172 0x373 0x64 0x28 0x00 0x00 0x00 0x00>;
			tpd-max-touch-num = <0x0a>;
			tpd-filter-enable = <0x01>;
			tpd-filter-pixel-density = <0x92>;
			tpd-filter-custom-prameters = <0x00 0x00 0x00 0x00 0x00 0x00 0x00 0x00 0x00 0x00 0x00 0x00>;
			tpd-filter-custom-speed = <0x00 0x00 0x00>;
			tpd-panel-match;
			pinctrl-names = "default\0state_eint_as_int\0state_eint_output0\0state_eint_output1\0state_rst_output0\0state_rst_output1";
			pinctrl-0 = <0x1f>;
			pinctrl-1 = <0x20>;
			pinctrl-2 = <0x21>;
			pinctrl-3 = <0x22>;
			pinctrl-4 = <0x23>;
			pinctrl-5 = <0x24>;
			status = "okay";
		};
	};

	fragment@9 {
		target = <0xffffffff>;

		__overlay__ {

			eint0default {
				phandle = <0x1f>;
			};

			eint@0 {
				phandle = <0x20>;

				pins_cmd_dat {
					pinmux = <0xa00>;
					slew-rate = <0x00>;
					bias-disable;
				};
			};

			eintoutput0 {
				phandle = <0x21>;

				pins_cmd_dat {
					pinmux = <0xa00>;
					slew-rate = <0x01>;
					output-low;
				};
			};

			eintoutput1 {
				phandle = <0x22>;

				pins_cmd_dat {
					pinmux = <0xa00>;
					slew-rate = <0x01>;
					output-high;
				};
			};

			rstoutput0 {
				phandle = <0x23>;

				pins_cmd_dat {
					pinmux = <0xa400>;
					slew-rate = <0x01>;
					output-low;
				};
			};

			rstoutput1 {
				phandle = <0x24>;

				pins_cmd_dat {
					pinmux = <0xa400>;
					slew-rate = <0x01>;
					output-high;
				};
			};
		};
	};

	fragment@10 {
		target = <0xffffffff>;

		__overlay__ {
			#address-cells = <0x01>;
			#size-cells = <0x00>;

			touch@0 {
				compatible = "mediatek,cap_touch\0himax,hxcommon\0novatek,NVT-ts-spi";
				spi-max-frequency = <0x989680>;
				reg = <0x00>;
				status = "okay";
				himax,panel-supplier = "hx83112a";
				ili,panel-supplier = "txd_ili7806s";
				ili,charger-psy-name = "battery";
				ili,fw-tp-module;
				novatek,reset-gpio = <0xffffffff 0xa4 0x00>;
				novatek,irq-gpio = <0xffffffff 0x0a 0x7d8>;
				novatek,panel-supplier = "tm_nt36672a\0djn_nt36525b_a\0djn_nt36525b";
				novatek,swrst-n8-addr = <0x3f0fe>;
				novatek,spi-rd-fast-addr = <0x3f310>;
			};
		};
	};

	fragment@11 {
		target = <0xffffffff>;

		__overlay__ {
		};
	};

	fragment@12 {
		target = <0xffffffff>;

		__overlay__ {
			atag,videolfb-fb_base_l = "~`P";
			atag,videolfb-fb_base_h = <0x00>;
			atag,videolfb-islcmfound = <0x01>;
			atag,videolfb-islcm_inited = <0x00>;
			atag,videolfb-fps = <0x1770>;
			atag,videolfb-vramSize = <0x17e8000>;
			atag,videolfb-lcmname = "nt35695_fhd_dsi_cmd_truly_rt5081_drv";
		};
	};

	fragment@13 {
		target = <0xffffffff>;

		__overlay__ {

			bq25601@6B {
				compatible = "ti,bq25601";
				reg = <0x6b>;
				ti,bq2560x,usb-vlim = <0x11f8>;
				ti,bq2560x,usb-ilim = <0x7d0>;
				ti,bq2560x,usb-vreg = <0x1130>;
				ti,bq2560x,usb-ichg = <0x7d0>;
				ti,bq2560x,precharge-current = <0xf0>;
				ti,bq2560x,termination-current = <0x3c>;
				ti,bq2560x,boost-voltage = <0x1386>;
				ti,bq2560x,boost-current = <0x4b0>;
				ti,bq2560x,enable_term;
				ti,bq2560x,stat-pin-ctrl = <0x03>;
				ti,bq2560x,vac-ovp-threshold = <0x1964>;
				phandle = <0x35>;
			};

			bq25601@3B {
				compatible = "ti,bq25601";
				reg = <0x3b>;
				ti,bq2560x,usb-vlim = <0x11f8>;
				ti,bq2560x,usb-ilim = <0x7d0>;
				ti,bq2560x,usb-vreg = <0x1130>;
				ti,bq2560x,usb-ichg = <0x7d0>;
				ti,bq2560x,precharge-current = <0xf0>;
				ti,bq2560x,termination-current = <0x3c>;
				ti,bq2560x,boost-voltage = <0x1386>;
				ti,bq2560x,boost-current = <0x4b0>;
				ti,bq2560x,enable_term;
				ti,bq2560x,stat-pin-ctrl = <0x03>;
				ti,bq2560x,vac-ovp-threshold = <0x1964>;
				phandle = <0x36>;
			};
		};
	};

	fragment@14 {
		target = <0xffffffff>;

		__overlay__ {

			ext_buck_vgpu@55 {
				regulator-name = "ext_buck_vgpu";
				regulator-min-microvolt = <0x493e0>;
				regulator-max-microvolt = <0x13d620>;
				vsel_pin = <0x02>;
			};
		};
	};

	fragment@15 {
		target = <0xffffffff>;

		__overlay__ {

			led@0 {
				compatible = "mediatek,red";
				led_mode = <0x00>;
				data = <0x01>;
				pwm_config = <0x00 0x00 0x00 0x00 0x00>;
				phandle = <0x46>;
			};

			led@1 {
				compatible = "mediatek,green";
				led_mode = <0x00>;
				data = <0x01>;
				pwm_config = <0x00 0x00 0x00 0x00 0x00>;
				phandle = <0x47>;
			};

			led@2 {
				compatible = "mediatek,blue";
				led_mode = <0x00>;
				data = <0x01>;
				pwm_config = <0x00 0x00 0x00 0x00 0x00>;
				phandle = <0x48>;
			};

			led@3 {
				compatible = "mediatek,jogball-backlight";
				led_mode = <0x00>;
				data = <0x01>;
				pwm_config = <0x00 0x00 0x00 0x00 0x00>;
				phandle = <0x49>;
			};

			led@4 {
				compatible = "mediatek,keyboard-backlight";
				led_mode = <0x00>;
				data = <0x01>;
				pwm_config = <0x00 0x00 0x00 0x00 0x00>;
				phandle = <0x4a>;
			};

			led@5 {
				compatible = "mediatek,button-backlight";
				led_mode = <0x00>;
				data = <0x01>;
				pwm_config = <0x00 0x00 0x00 0x00 0x00>;
				phandle = <0x4b>;
			};

			led@6 {
				compatible = "mediatek,lcd-backlight";
				max-brightness = <0x666>;
				led_mode = <0x04>;
				data = <0x01>;
				pwm_config = <0x00 0x01 0x00 0x00 0x00>;
				phandle = <0x4c>;
			};

			led@7 {
				compatible = "mediatek,charging";
				led_mode = <0x03>;
				phandle = <0x4d>;
			};

			vibrator@0 {
				compatible = "mediatek,vibrator";
				vib_timer = <0x19>;
				vib_limit = <0x09>;
				vib_vol = <0x09>;
				phandle = <0x4e>;
			};

			usb_phy_init {
				compatible = "mediatek,phy_tuning";
				u2_vrt_ref = <0x07>;
				u2_term_ref = <0x03>;
				u2_enhance = <0x03>;
				status = "okay";
				phandle = <0x4f>;
			};
		};
	};

	fragment@16 {
		target = <0xffffffff>;

		__overlay__ {
			min-volt = <0x2dc6c0>;
		};
	};

	fragment@17 {
		target = <0xffffffff>;

		__overlay__ {

			lcm_rst_out0_gpio {
				phandle = <0x26>;

				pins_cmd_dat {
					pinmux = <0x2d00>;
					slew-rate = <0x01>;
					output-low;
				};
			};

			lcm_rst_out1_gpio {
				phandle = <0x27>;

				pins_cmd_dat {
					pinmux = <0x2d00>;
					slew-rate = <0x01>;
					output-high;
				};
			};

			lcd_bias_enp0_gpio {
				phandle = <0x28>;

				pins_cmd_dat {
					pinmux = <0x1000>;
					slew-rate = <0x01>;
					output-low;
				};
			};

			lcd_bias_enp1_gpio {
				phandle = <0x29>;

				pins_cmd_dat {
					pinmux = <0x1000>;
					slew-rate = <0x01>;
					output-high;
				};
			};

			lcd_bias_enn0_gpio {
				phandle = <0x2a>;

				pins_cmd_dat {
					pinmux = <0xd00>;
					slew-rate = <0x01>;
					output-low;
				};
			};

			lcd_bias_enn1_gpio {
				phandle = <0x2b>;

				pins_cmd_dat {
					pinmux = <0xd00>;
					slew-rate = <0x01>;
					output-high;
				};
			};

			lcm_pwr_en_out0_gpio {
				phandle = <0x2c>;

				pins_cmd_dat {
					pinmux = <0xa500>;
					slew-rate = <0x01>;
					output-low;
				};
			};

			lcm_pwr_en_out1_gpio {
				phandle = <0x2d>;

				pins_cmd_dat {
					pinmux = <0xa500>;
					slew-rate = <0x01>;
					output-high;
				};
			};

			dispdefault {
				phandle = <0x25>;
			};
		};
	};

	fragment@18 {
		target = <0xffffffff>;

		__overlay__ {
			pinctrl-names = "dispdefault\0lcm_rst_out0_gpio\0lcm_rst_out1_gpio\0lcd_bias_enp0_gpio\0lcd_bias_enp1_gpio\0lcd_bias_enn0_gpio\0lcd_bias_enn1_gpio\0lcm_pwr_en_out0_gpio\0lcm_pwr_en_out1_gpio";
			pinctrl-0 = <0x25>;
			pinctrl-1 = <0x26>;
			pinctrl-2 = <0x27>;
			pinctrl-3 = <0x28>;
			pinctrl-4 = <0x29>;
			pinctrl-5 = <0x2a>;
			pinctrl-6 = <0x2b>;
			pinctrl-7 = <0x2c>;
			pinctrl-8 = <0x2d>;
			status = "okay";
		};
	};

	fragment@19 {
		target = <0xffffffff>;

		__overlay__ {
			clock-frequency = <0x61a80>;

			mtk-usb@60 {
				compatible = "mediatek,mtk-usb";
				reg = <0x60>;
				status = "okay";
			};
		};
	};

	fragment@20 {
		target = <0xffffffff>;

		__overlay__ {

			i2c_lcd_bias@3e {
				compatible = "mediatek,i2c_lcd_bias";
				reg = <0x3e>;
				status = "okay";
			};

			fs16xx@34 {
				compatible = "foursemi,fs16xx";
				reg = <0x34>;
				fsm,re25-dft = <0x1c00>;
				status = "okay";
			};
		};
	};

	fragment@21 {
		target = <0xffffffff>;

		__overlay__ {

			ext_buck_lp4@57 {
				regulator-name = "ext_buck_vdd2";
				regulator-min-microvolt = <0x493e0>;
				regulator-max-microvolt = <0x13d620>;
				vsel_pin = <0x00>;
			};

			ext_buck_lp4x@50 {
				regulator-name = "ext_buck_vddq";
				regulator-min-microvolt = <0x493e0>;
				regulator-max-microvolt = <0x13d620>;
				vsel_pin = <0x01>;
			};
		};
	};

	fragment@22 {
		target = <0xffffffff>;

		__overlay__ {
			status = "ok";

			abov_sar@20 {
				status = "ok";
				compatible = "abov,abov_sar_mmi_overlay_7ch";
				reg = <0x20>;
				cap_vdd-supply = <0xffffffff>;
				interrupt-parent = <0xffffffff>;
				interrupts = <0x01 0x02 0x01 0x00>;
				abov,irq-gpio-std = <0xffffffff 0x0c 0x00>;
				reg_array_len = <0x03>;
				reg_array_val = <0x07 0x00 0x08 0x1f 0xfb 0x01>;
				cap,use_channel_ch0 = <0x00>;
				cap,use_channel_ch1 = <0x01>;
				cap,use_channel_ch2 = <0x02>;
				ch0_name = "capsense_bottom";
				ch1_name = "capsense_top_right";
				ch2_name = "capsense_top_left";
				label = "AbovCapSense";
				cap,channel_number = <0x03>;
				cap,fw_mode_ret = <0x39>;
				button_mask = <0x15>;
				cap,flash_erase_time = <0x578>;
			};
		};
	};

	fragment@23 {
		target = <0xffffffff>;

		__overlay__ {

			consys_default {
				phandle = <0x2e>;
			};

			gpslna@0 {
				phandle = <0x2f>;

				pins_cmd_dat {
					pinmux = <0x5b00>;
					slew-rate = <0x00>;
					bias-disable;
					output-low;
				};
			};

			gpslna@1 {
				phandle = <0x30>;

				pins_cmd_dat {
					pinmux = <0x5b00>;
					slew-rate = <0x01>;
					output-high;
				};
			};

			gpslna@2 {
				phandle = <0x31>;

				pins_cmd_dat {
					pinmux = <0x5b00>;
					slew-rate = <0x01>;
					output-low;
				};
			};
		};
	};

	fragment@24 {
		target = <0xffffffff>;

		__overlay__ {
			pinctrl-names = "default\0gps_lna_state_init\0gps_lna_state_oh\0gps_lna_state_ol";
			pinctrl-0 = <0x2e>;
			pinctrl-1 = <0x2f>;
			pinctrl-2 = <0x30>;
			pinctrl-3 = <0x31>;
			status = "okay";
		};
	};

	fragment@25 {
		target = <0xffffffff>;

		__overlay__ {
			pinctrl-names = "default";
			pinctrl-0 = <0x32>;
		};
	};

	fragment@26 {
		target = <0xffffffff>;

		__overlay__ {

			kpdgpiodefault {
				phandle = <0x32>;

				pins_cmd_dat {
					pinmux = <0x5d01>;
					bias-pull-up = <0x66>;
					output-low;
					input-schmitt-enable;
				};
			};
		};
	};

	fragment@27 {
		target = <0xffffffff>;

		__overlay__ {
			compatible = "mediatek,touch";
		};
	};

	fragment@28 {
		target = <0xffffffff>;

		__overlay__ {
			accdet-mic-vol = <0x06>;
			headset-mode-setting = <0x500 0x500 0x01 0x1f0 0x800 0x800 0x20 0x44>;
			accdet-plugout-debounce = <0x01>;
			accdet-mic-mode = <0x01>;
			headset-eint-level-pol = <0x08>;
			headset-three-key-threshold = <0x00 0x50 0xdc 0x190>;
			headset-three-key-threshold-CDD = <0x00 0x79 0xc0 0x258>;
			headset-four-key-threshold = <0x00 0x3a 0x79 0xc0 0x190>;
			pinctrl-names = "default\0state_eint_as_int";
			pinctrl-0 = <0x33>;
			pinctrl-1 = <0x34>;
			status = "okay";
		};
	};

	fragment@29 {
		target = <0xffffffff>;

		__overlay__ {

			accdetdefault {
				phandle = <0x33>;
			};

			accdeteint@0 {
				phandle = <0x34>;

				pins_cmd_dat {
					pinmux = <0x900>;
					slew-rate = <0x00>;
					bias-disable;
				};
			};
		};
	};

	fragment@30 {
		target = <0xffffffff>;

		__overlay__ {
		};
	};

	fragment@31 {
		target = <0xffffffff>;

		__overlay__ {
			compatible = "mmi,moto-chg-tcmd";
			status = "okay";
			mmi,ntc_table = <0x01>;
			mmi,ntc_v_ref = <0x1b7740>;
			mmi,ntc_r_pull = <0x186a0>;
			mmi,batid_v_ref = <0x1b7740>;
			mmi,batid_r_pull = <0x186a0>;
			mmi,adc-channel-cpu = <0x00>;
			mmi,adc-channel-charger = <0x02>;
			mmi,adc-channel-pa = <0x01>;
			mmi,adc-channel-batid = <0x03>;
			mmi,adc-channel-vbat = <0x64>;
		};
	};

	fragment@32 {
		target = <0xffffffff>;

		__overlay__ {
			cd_level = [01];
		};
	};

	fragment@33 {
		target = <0xffffffff>;

		__overlay__ {
			bc12_active = <0x00>;
			bootmode = <0xffffffff>;
		};
	};

	fragment@34 {
		target = <0xffffffff>;

		__overlay__ {
			charger = <0xffffffff>;
			extern_charger = <0x35>;
			extern_charger_3rd = <0x36>;
			g_temperature = <0x32 0x19 0x0a 0x00 0xfffffff6 0xffffffe7 0xffffffe2 0xffffffdd 0xffffffd8 0xffffffd3>;
			g_FG_PSEUDO100 = <0x62 0x62 0x64 0x64 0x62 0x62 0x64 0x64 0x62 0x62 0x64 0x64 0x62 0x62 0x64 0x64 0x62 0x62 0x64 0x64 0x64 0x64 0x64 0x64 0x64 0x64 0x64 0x64 0x64 0x64 0x64 0x64 0x64 0x64 0x64 0x64 0x64 0x64 0x64 0x64>;
			g_Q_MAX = <0xfeb 0xf5b 0x9ba 0x7ad 0x1009 0xfa1 0x9a4 0x7c0 0x1071 0xf81 0x906 0x79a 0xfdb 0xf86 0x742 0x751 0xfab 0xf6e 0x733 0x73b 0x8a3 0x674 0x5fd 0x605 0x899 0x66a 0x5f3 0x5fb 0x88f 0x660 0x5e9 0x5f1 0x885 0x656 0x5df 0x5e7 0x87b 0x64c 0x5d5 0x5dd>;
			g_Q_MAX_H_CURRENT = <0xfeb 0xf46 0x88e 0x681 0x1009 0xf83 0x878 0x694 0x1071 0xf4f 0x7da 0x66e 0xfdb 0xec5 0x616 0x625 0xfab 0xc63 0x607 0x60f 0x8a2 0x672 0x5fd 0x605 0x898 0x668 0x5f3 0x5fb 0x88e 0x65e 0x5e9 0x5f1 0x884 0x654 0x5df 0x5e7 0x87a 0x64a 0x5d5 0x5dd>;
			SHUTDOWN_1_TIME = <0x07>;
			ACTIVE_TABLE = <0x05>;
			EMBEDDED_SEL = <0x01>;
			DIFFERENCE_FULLOCV_ITH = <0x50>;
			VIR_OLDOCV_DIFF_EMB = <0xbb8>;
			VIR_OLDOCV_DIFF_EMB_LT = <0xbb8>;
			df-serialnum = "SB18D15207";
			serialnum_0 = "SB18D15207";
			battery0_name = "S96767AA1_ATL_4V4_4000MAH";
			battery0_profile_t0_num = <0x64>;
			battery0_profile_t0_col = <0x03>;
			battery0_profile_t0 = <0x00 0xaaf0 0x49c 0x1ad 0xaa2b 0x49c 0x35b 0xa982 0x49c 0x508 0xa8ea 0x496 0x6b5 0xa861 0x492 0x862 0xa7dd 0x492 0xa10 0xa755 0x492 0xbbd 0xa6d5 0x492 0xd6a 0xa65c 0x492 0xf18 0xa5df 0x492 0x10c5 0xa565 0x498 0x1272 0xa4ed 0x49c 0x1420 0xa474 0x49c 0x15cd 0xa3fc 0x49d 0x177a 0xa384 0x4a6 0x1927 0xa314 0x4a6 0x1ad5 0xa29e 0x4a6 0x1c82 0xa225 0x4ac 0x1e2f 0xa1b2 0x4b0 0x1fdd 0xa142 0x4b3 0x218a 0xa0d2 0x4bc 0x2337 0xa063 0x4c4 0x24e4 0x9ff3 0x4c4 0x2692 0x9f83 0x4c4 0x283f 0x9f1a 0x4c4 0x29ec 0x9eb4 0x4c8 0x2b9a 0x9e51 0x4d1 0x2d47 0x9df1 0x4db 0x2ef4 0x9d8a 0x4ec 0x30a1 0x9d23 0x4ec 0x324f 0x9cc3 0x4f3 0x33fc 0x9c6a 0x4fc 0x35a9 0x9c10 0x500 0x3757 0x9bb5 0x506 0x3904 0x9b5f 0x517 0x3ab1 0x9b09 0x528 0x3c5f 0x9abc 0x531 0x3e0c 0x9a6f 0x548 0x3fb9 0x9a1b 0x55c 0x4166 0x99ca 0x56d 0x4314 0x997a 0x57e 0x44c1 0x991f 0x587 0x466e 0x98b2 0x56e 0x481c 0x9829 0x50f 0x49c9 0x97ae 0x4d5 0x4b76 0x974c 0x4b3 0x4d23 0x96ff 0x4a6 0x4ed1 0x96bd 0x4a6 0x507e 0x9681 0x4a6 0x522b 0x9645 0x4a6 0x53d9 0x9609 0x49d 0x5586 0x95dc 0x4a3 0x5733 0x95ab 0x4a6 0x58e1 0x9577 0x4a6 0x5a8e 0x954a 0x4a6 0x5c3b 0x9526 0x4a9 0x5de8 0x94fb 0x4ba 0x5f96 0x94d0 0x4ba 0x6143 0x94ad 0x4c1 0x62f0 0x9485 0x4ca 0x649e 0x9463 0x4ce 0x664b 0x9446 0x4d4 0x67f8 0x9424 0x4e4 0x69a5 0x9402 0x4ec 0x6b53 0x93e8 0x4f5 0x6d00 0x93ce 0x4fd 0x6ead 0x93b4 0x512 0x705b 0x9396 0x515 0x7208 0x936b 0x4fe 0x73b5 0x932b 0x4d8 0x7563 0x92de 0x4a6 0x7710 0x929a 0x4a6 0x78bd 0x9272 0x4bc 0x7a6a 0x924a 0x4be 0x7c18 0x921b 0x4b6 0x7dc5 0x91ee 0x4b0 0x7f72 0x91ca 0x4b2 0x8120 0x91a0 0x4ba 0x82cd 0x9186 0x4d4 0x847a 0x9156 0x4d1 0x8627 0x911d 0x4c8 0x87d5 0x90dc 0x4c4 0x8982 0x909b 0x4c7 0x8b2f 0x905b 0x4cb 0x8cdd 0x900e 0x4b9 0x8e8a 0x8fca 0x4a0 0x9037 0x8fb9 0x4ab 0x91e4 0x8faa 0x4c8 0x9392 0x8f9d 0x4ef 0x953f 0x8f8f 0x526 0x96ec 0x8f64 0x564 0x989a 0x8ef3 0x563 0x9a47 0x8d79 0x51e 0x9bf4 0x8b6e 0x538 0x9da2 0x88aa 0x587 0x9f4f 0x847b 0x63e 0xa0fc 0x811a 0x6ea 0xa2a9 0x811a 0x6ea 0xa457 0x811a 0x6ea 0xa604 0x811a 0x6ea>;
			battery0_profile_t1_num = <0x64>;
			battery0_profile_t1_col = <0x03>;
			battery0_profile_t1 = <0x00 0xaafa 0x5b4 0x1ad 0xaa46 0x5b4 0x35b 0xa9ae 0x5b4 0x508 0xa922 0x5b4 0x6b5 0xa899 0x5ab 0x862 0xa812 0x5a3 0xa10 0xa793 0x5a8 0xbbd 0xa71a 0x5a0 0xd6a 0xa69a 0x5a0 0xf18 0xa620 0x5a0 0x10c5 0xa5a8 0x5a0 0x1272 0xa530 0x5a4 0x1420 0xa4b5 0x5aa 0x15cd 0xa435 0x5aa 0x177a 0xa3bd 0x5aa 0x1927 0xa34e 0x5b3 0x1ad5 0xa2d7 0x5b4 0x1c82 0xa265 0x5ba 0x1e2f 0xa1f0 0x5c7 0x1fdd 0xa17b 0x5d2 0x218a 0xa10c 0x5d5 0x2337 0xa09c 0x5e6 0x24e4 0xa02c 0x5ef 0x2692 0x9fc4 0x5f7 0x283f 0x9f63 0x600 0x29ec 0x9f05 0x60d 0x2b9a 0x9ea3 0x61e 0x2d47 0x9e3a 0x631 0x2ef4 0x9dca 0x64a 0x30a1 0x9d52 0x64a 0x324f 0x9ce9 0x661 0x33fc 0x9c82 0x668 0x35a9 0x9c25 0x67b 0x3757 0x9bcf 0x693 0x3904 0x9b79 0x69a 0x3ab1 0x9b24 0x69c 0x3c5f 0x9ae8 0x6be 0x3e0c 0x9a9d 0x6d1 0x3fb9 0x9a49 0x6e9 0x4166 0x99f4 0x6f4 0x4314 0x999a 0x6ea 0x44c1 0x9936 0x6c6 0x466e 0x98be 0x680 0x481c 0x9845 0x62a 0x49c9 0x97d5 0x5dc 0x4b76 0x9772 0x5af 0x4d23 0x971d 0x591 0x4ed1 0x96d8 0x57b 0x507e 0x969d 0x570 0x522b 0x9661 0x578 0x53d9 0x962d 0x578 0x5586 0x95fa 0x578 0x5733 0x95c6 0x57e 0x58e1 0x9598 0x587 0x5a8e 0x956d 0x58c 0x5c3b 0x9544 0x58e 0x5de8 0x9521 0x597 0x5f96 0x94f6 0x59f 0x6143 0x94d3 0x5a0 0x62f0 0x94b1 0x5b3 0x649e 0x948e 0x5b9 0x664b 0x946f 0x5bf 0x67f8 0x9454 0x5d2 0x69a5 0x9433 0x5d3 0x6b53 0x9421 0x5e5 0x6d00 0x9400 0x5e6 0x6ead 0x93e5 0x5ec 0x705b 0x93cb 0x5eb 0x7208 0x93b1 0x5e6 0x73b5 0x9395 0x5df 0x7563 0x9373 0x5c6 0x7710 0x9350 0x5ac 0x78bd 0x932e 0x5aa 0x7a6a 0x9305 0x59d 0x7c18 0x92da 0x596 0x7dc5 0x92b3 0x596 0x7f72 0x9291 0x596 0x8120 0x926e 0x598 0x82cd 0x924c 0x5a9 0x847a 0x9222 0x5b2 0x8627 0x91e9 0x5ad 0x87d5 0x91ad 0x5af 0x8982 0x9171 0x5b8 0x8b2f 0x9133 0x5c0 0x8cdd 0x90eb 0x5c6 0x8e8a 0x908c 0x5b5 0x9037 0x905f 0x5ac 0x91e4 0x904f 0x5be 0x9392 0x9047 0x5e3 0x953f 0x903a 0x612 0x96ec 0x9021 0x648 0x989a 0x8fe5 0x67b 0x9a47 0x8f30 0x672 0x9bf4 0x8d6b 0x67a 0x9da2 0x8b0b 0x6ba 0x9f4f 0x87ac 0x754 0xa0fc 0x817f 0xca9 0xa2a9 0x7b66 0x13ec 0xa457 0x7b66 0x13ec 0xa604 0x7b66 0x13ec>;
			battery0_profile_t2_num = <0x64>;
			battery0_profile_t2_col = <0x03>;
			battery0_profile_t2 = <0x00 0xab54 0x94c 0x1ad 0xaa97 0x94c 0x35b 0xa9f7 0x93e 0x508 0xa968 0x927 0x6b5 0xa8e3 0x91a 0x862 0xa862 0x90b 0xa10 0xa7e3 0x8e6 0xbbd 0xa76a 0x8de 0xd6a 0xa6ea 0x8d5 0xf18 0xa677 0x8d4 0x10c5 0xa602 0x8da 0x1272 0xa58a 0x8da 0x1420 0xa512 0x8d1 0x15cd 0xa499 0x8c8 0x177a 0xa421 0x8c0 0x1927 0xa3b2 0x8c0 0x1ad5 0xa342 0x8c0 0x1c82 0xa2cd 0x8c6 0x1e2f 0xa259 0x8d8 0x1fdd 0xa1e9 0x8eb 0x218a 0xa17a 0x8f2 0x2337 0xa10a 0x8f2 0x24e4 0xa09a 0x8fb 0x2692 0xa032 0x903 0x283f 0x9fcb 0x90c 0x29ec 0x9f6e 0x91e 0x2b9a 0x9f14 0x93e 0x2d47 0x9eb6 0x972 0x2ef4 0x9e56 0x9c4 0x30a1 0x9dd5 0x9bb 0x324f 0x9d45 0x9a3 0x33fc 0x9cc0 0x990 0x35a9 0x9c52 0x991 0x3757 0x9bfa 0x9a6 0x3904 0x9bab 0x9b6 0x3ab1 0x9b55 0x9a5 0x3c5f 0x9b08 0x99d 0x3e0c 0x9aac 0x994 0x3fb9 0x9a5a 0x98c 0x4166 0x9a08 0x97e 0x4314 0x99ae 0x95f 0x44c1 0x994e 0x92a 0x466e 0x98e7 0x8ee 0x481c 0x9880 0x8b2 0x49c9 0x9820 0x885 0x4b76 0x97c2 0x861 0x4d23 0x976d 0x843 0x4ed1 0x9720 0x82d 0x507e 0x96d7 0x81c 0x522b 0x969b 0x80c 0x53d9 0x965f 0x80c 0x5586 0x962b 0x80c 0x5733 0x95f7 0x80c 0x58e1 0x95c4 0x81b 0x5a8e 0x9594 0x826 0x5c3b 0x9569 0x824 0x5de8 0x953e 0x835 0x5f96 0x9513 0x83d 0x6143 0x94f0 0x846 0x62f0 0x94ce 0x848 0x649e 0x94ab 0x857 0x664b 0x9489 0x86a 0x67f8 0x9469 0x872 0x69a5 0x944e 0x87b 0x6b53 0x942c 0x883 0x6d00 0x9412 0x88c 0x6ead 0x93f8 0x88e 0x705b 0x93de 0x893 0x7208 0x93c8 0x89c 0x73b5 0x93b5 0x8a4 0x7563 0x939c 0x8ac 0x7710 0x938b 0x8ac 0x78bd 0x937a 0x8b4 0x7a6a 0x9368 0x8c4 0x7c18 0x9352 0x8cf 0x7dc5 0x9334 0x8d4 0x7f72 0x9312 0x8cf 0x8120 0x92f0 0x8c2 0x82cd 0x92cd 0x8d3 0x847a 0x92a3 0x8dc 0x8627 0x927f 0x8ec 0x87d5 0x9251 0x902 0x8982 0x921a 0x914 0x8b2f 0x91de 0x925 0x8cdd 0x91a2 0x948 0x8e8a 0x9165 0x973 0x9037 0x9119 0x99e 0x91e4 0x90c4 0x99f 0x9392 0x908a 0x9b8 0x953f 0x906c 0x9e7 0x96ec 0x905b 0xa28 0x989a 0x9048 0xa8c 0x9a47 0x902e 0xb0c 0x9bf4 0x9004 0xbe2 0x9da2 0x8f7d 0xcb2 0x9f4f 0x8e2d 0xd69 0xa0fc 0x8c23 0xe90 0xa2a9 0x8953 0x10b4 0xa457 0x8527 0x154b 0xa604 0x7e36 0x212a>;
			battery0_profile_t3_num = <0x64>;
			battery0_profile_t3_col = <0x03>;
			battery0_profile_t3 = <0x00 0xab72 0x1acc 0x1ad 0xaab5 0x1acc 0x35b 0xaa15 0x1ab6 0x508 0xa980 0x1a91 0x6b5 0xa8f3 0x1a59 0x862 0xa86d 0x1a15 0xa10 0xa7ed 0x19d0 0xbbd 0xa764 0x1983 0xd6a 0xa6e3 0x193e 0xf18 0xa669 0x18f9 0x10c5 0xa5eb 0x18ba 0x1272 0xa56f 0x187e 0x1420 0xa4f4 0x1842 0x15cd 0xa474 0x1806 0x177a 0xa3fc 0x17ca 0x1927 0xa384 0x1796 0x1ad5 0xa315 0x176b 0x1c82 0xa2a0 0x173b 0x1e2f 0xa22c 0x170b 0x1fdd 0xa1bc 0x16e6 0x218a 0xa14c 0x16c8 0x2337 0xa0d3 0x1695 0x24e4 0xa064 0x1672 0x2692 0x9ffb 0x1650 0x283f 0x9f94 0x1644 0x29ec 0x9f2d 0x1644 0x2b9a 0x9ec6 0x163e 0x2d47 0x9e5b 0x1625 0x2ef4 0x9ddd 0x15e2 0x30a1 0x9d4b 0x1594 0x324f 0x9cc0 0x1547 0x33fc 0x9c3d 0x1505 0x35a9 0x9bc4 0x14d1 0x3757 0x9b5a 0x14af 0x3904 0x9afa 0x149c 0x3ab1 0x9a93 0x1482 0x3c5f 0x9a3d 0x1460 0x3e0c 0x99d9 0x1430 0x3fb9 0x9979 0x1402 0x4166 0x991b 0x13d8 0x4314 0x98bd 0x13b2 0x44c1 0x9860 0x1397 0x466e 0x980a 0x1375 0x481c 0x97b4 0x1363 0x49c9 0x976c 0x1360 0x4b76 0x9722 0x1360 0x4d23 0x96dd 0x1364 0x4ed1 0x969e 0x136f 0x507e 0x965b 0x137f 0x522b 0x9620 0x1388 0x53d9 0x95ec 0x13a1 0x5586 0x95b9 0x13b4 0x5733 0x9585 0x13d0 0x58e1 0x9556 0x13f2 0x5a8e 0x952b 0x1412 0x5c3b 0x9500 0x142c 0x5de8 0x94d5 0x1445 0x5f96 0x94aa 0x1470 0x6143 0x9486 0x148d 0x62f0 0x9464 0x14b1 0x649e 0x9442 0x14d4 0x664b 0x9422 0x14f5 0x67f8 0x9409 0x1525 0x69a5 0x93ef 0x153f 0x6b53 0x93dd 0x157a 0x6d00 0x93cc 0x15b6 0x6ead 0x93b6 0x15f2 0x705b 0x93a0 0x1636 0x7208 0x938f 0x1689 0x73b5 0x937c 0x16e8 0x7563 0x9363 0x174d 0x7710 0x9349 0x17bd 0x78bd 0x9329 0x183a 0x7a6a 0x930c 0x18c0 0x7c18 0x92ea 0x1951 0x7dc5 0x92bf 0x19ee 0x7f72 0x9294 0x1a95 0x8120 0x9269 0x1b52 0x82cd 0x9236 0x1c0f 0x847a 0x91f5 0x1cd9 0x8627 0x91b1 0x1daf 0x87d5 0x916d 0x1e98 0x8982 0x9128 0x1f9d 0x8b2f 0x90e3 0x20c1 0x8cdd 0x9095 0x21e5 0x8e8a 0x9059 0x2342 0x9037 0x9031 0x24d2 0x91e4 0x900f 0x26b4 0x9392 0x8fe8 0x28e7 0x953f 0x8fb1 0x2b69 0x96ec 0x8f4e 0x2e3f 0x989a 0x8e9a 0x3133 0x9a47 0x8d1e 0x33ae 0x9bf4 0x8ad3 0x36b5 0x9da2 0x8777 0x3ab2 0x9f4f 0x8552 0x3d2c 0xa0fc 0x8552 0x3d2c 0xa2a9 0x8552 0x3d2c 0xa457 0x8552 0x3d2c 0xa604 0x8552 0x3d2c>;
			battery0_profile_t4_num = <0x64>;
			battery0_profile_t4_col = <0x03>;
			battery0_profile_t4 = <0x00 0xab7c 0x35a2 0x1ad 0xaa9d 0x35a2 0x35b 0xa9d3 0x357e 0x508 0xa919 0x34fd 0x6b5 0xa86b 0x344f 0x862 0xa7c4 0x3394 0xa10 0xa722 0x32c6 0xbbd 0xa688 0x31f8 0xd6a 0xa5f6 0x313b 0xf18 0xa56b 0x3085 0x10c5 0xa4e1 0x2fed 0x1272 0xa45c 0x2f4b 0x1420 0xa3dc 0x2ea4 0x15cd 0xa35d 0x2e2a 0x177a 0xa2e7 0x2da3 0x1927 0xa26f 0x2d2b 0x1ad5 0xa1f6 0x2cb2 0x1c82 0xa17e 0x2c35 0x1e2f 0xa106 0x2bc4 0x1fdd 0xa090 0x2b66 0x218a 0xa022 0x2b0b 0x2337 0x9fbb 0x2ac7 0x24e4 0x9f54 0x2a8b 0x2692 0x9eda 0x2a26 0x283f 0x9e55 0x29ac 0x29ec 0x9dc7 0x291f 0x2b9a 0x9d35 0x288d 0x2d47 0x9ca5 0x280d 0x2ef4 0x9c1b 0x2795 0x30a1 0x9ba3 0x2746 0x324f 0x9b38 0x270e 0x33fc 0x9ad8 0x26d0 0x35a9 0x9a7f 0x26b8 0x3757 0x9a29 0x26c5 0x3904 0x99d2 0x26b2 0x3ab1 0x9973 0x268f 0x3c5f 0x9925 0x2675 0x3e0c 0x98d1 0x2654 0x3fb9 0x987b 0x2632 0x4166 0x982a 0x2620 0x4314 0x97dd 0x2620 0x44c1 0x9792 0x261e 0x466e 0x974d 0x260d 0x481c 0x9708 0x25fc 0x49c9 0x96c4 0x2613 0x4b76 0x9684 0x261b 0x4d23 0x9648 0x2622 0x4ed1 0x960c 0x2639 0x507e 0x95d1 0x264c 0x522b 0x959f 0x266e 0x53d9 0x956b 0x2688 0x5586 0x953f 0x26a2 0x5733 0x950e 0x26b1 0x58e1 0x94e3 0x26d5 0x5a8e 0x94be 0x2710 0x5c3b 0x9495 0x2737 0x5de8 0x947b 0x2784 0x5f96 0x9459 0x27b1 0x6143 0x943e 0x27ef 0x62f0 0x942a 0x2843 0x649e 0x9415 0x28a1 0x664b 0x93fd 0x2904 0x67f8 0x93eb 0x2974 0x69a5 0x93d1 0x29e4 0x6b53 0x93b8 0x2a6c 0x6d00 0x93a5 0x2b02 0x6ead 0x938e 0x2ba2 0x705b 0x9375 0x2c57 0x7208 0x935b 0x2d1b 0x73b5 0x9341 0x2dd3 0x7563 0x931e 0x2ea9 0x7710 0x92fc 0x2f98 0x78bd 0x92da 0x3088 0x7a6a 0x92b7 0x3179 0x7c18 0x9295 0x3274 0x7dc5 0x926e 0x3379 0x7f72 0x923c 0x3470 0x8120 0x9211 0x358b 0x82cd 0x91df 0x367f 0x847a 0x91a5 0x377c 0x8627 0x9169 0x3883 0x87d5 0x912c 0x3986 0x8982 0x90f0 0x3a81 0x8b2f 0x90b5 0x3b81 0x8cdd 0x9083 0x3c76 0x8e8a 0x9057 0x3d9d 0x9037 0x902c 0x3ec9 0x91e4 0x9006 0x4028 0x9392 0x8fd6 0x41ae 0x953f 0x8f7e 0x433f 0x96ec 0x8edf 0x44e4 0x989a 0x8dbb 0x4692 0x9a47 0x8bd2 0x48d5 0x9bf4 0x890d 0x4c15 0x9da2 0x87be 0x4d9e 0x9f4f 0x87be 0x4d9e 0xa0fc 0x87be 0x4d9e 0xa2a9 0x87be 0x4d9e 0xa457 0x87be 0x4d9e 0xa604 0x87be 0x4d9e>;
			serialnum_1 = "SB18D15249";
			battery1_name = "S96767AA1_SUN_4V4_4000MAH";
			battery1_profile_t0_num = <0x64>;
			battery1_profile_t0_col = <0x03>;
			battery1_profile_t0 = <0x00 0xa992 0x44c 0x199 0xa8ff 0x44c 0x332 0xa878 0x45f 0x4cb 0xa7f5 0x45c 0x664 0xa775 0x454 0x7fd 0xa6fa 0x46a 0x997 0xa680 0x46a 0xb30 0xa605 0x46a 0xcc9 0xa58a 0x45a 0xe62 0xa513 0x457 0xffb 0xa49f 0x465 0x1194 0xa424 0x44c 0x132d 0xa3b1 0x465 0x14c6 0xa33f 0x46a 0x165f 0xa2cc 0x46a 0x17f8 0xa25d 0x46a 0x1991 0xa1f1 0x46a 0x1b2b 0xa17f 0x46a 0x1cc4 0xa10c 0x46a 0x1e5d 0xa09f 0x46a 0x1ff6 0xa035 0x46a 0x218f 0x9fca 0x46a 0x2328 0x9f60 0x46a 0x24c1 0x9efe 0x47a 0x265a 0x9e9c 0x491 0x27f3 0x9e35 0x48e 0x298c 0x9dcd 0x47e 0x2b25 0x9d6c 0x481 0x2cbf 0x9d12 0x499 0x2e58 0x9cb1 0x486 0x2ff1 0x9c59 0x499 0x318a 0x9c04 0x4a9 0x3323 0x9bac 0x4a0 0x34bc 0x9b5a 0x4b0 0x3655 0x9b08 0x4c9 0x37ee 0x9ab6 0x4db 0x3987 0x9a65 0x4e2 0x3b20 0x9a15 0x4f0 0x3cb9 0x99ca 0x514 0x3e53 0x9970 0x514 0x3fec 0x9900 0x4f0 0x4185 0x9883 0x4bc 0x431e 0x9807 0x48a 0x44b7 0x979c 0x46a 0x4650 0x974a 0x46a 0x47e9 0x9709 0x46a 0x4982 0x96c7 0x46a 0x4b1b 0x968a 0x46a 0x4cb4 0x9651 0x46a 0x4e4d 0x9619 0x46a 0x4fe7 0x95e7 0x46a 0x5180 0x95b6 0x46a 0x5319 0x9585 0x46a 0x54b2 0x9558 0x46a 0x564b 0x952f 0x46a 0x57e4 0x9506 0x46a 0x597d 0x94dd 0x46a 0x5b16 0x94b4 0x46a 0x5caf 0x9490 0x473 0x5e48 0x946f 0x47e 0x5fe1 0x944e 0x47e 0x617b 0x942e 0x47e 0x6314 0x940d 0x47e 0x64ad 0x93f2 0x48e 0x6646 0x93d5 0x49c 0x67df 0x93b7 0x4a0 0x6978 0x939e 0x4b0 0x6b11 0x937d 0x4b0 0x6caa 0x9349 0x4a3 0x6e43 0x9303 0x478 0x6fdc 0x92b9 0x454 0x7175 0x9281 0x46a 0x730f 0x9259 0x46a 0x74a8 0x9230 0x479 0x7641 0x9201 0x473 0x77da 0x91d7 0x471 0x7973 0x91b5 0x47a 0x7b0c 0x918c 0x46a 0x7ca5 0x916b 0x47a 0x7e3e 0x9144 0x47e 0x7fd7 0x9117 0x47e 0x8170 0x90e0 0x479 0x8309 0x90a1 0x46c 0x84a3 0x906f 0x47c 0x863c 0x9030 0x47e 0x87d5 0x8fe9 0x463 0x896e 0x8fb5 0x457 0x8b07 0x8fa0 0x473 0x8ca0 0x8f98 0x49c 0x8e39 0x8f88 0x4c5 0x8fd2 0x8f71 0x4fb 0x916b 0x8f2f 0x514 0x9304 0x8e81 0x501 0x949d 0x8d28 0x4d0 0x9637 0x8b46 0x4e0 0x97d0 0x88ca 0x52b 0x9969 0x853b 0x5b3 0x9b02 0x7eea 0x109c 0x9c9b 0x77ce 0x2314 0x9e34 0x77ce 0x2314>;
			battery1_profile_t1_num = <0x64>;
			battery1_profile_t1_col = <0x03>;
			battery1_profile_t1 = <0x00 0xaa78 0x500 0x199 0xa9cc 0x500 0x332 0xa93a 0x50d 0x4cb 0xa8b3 0x514 0x664 0xa833 0x51c 0x7fd 0xa7b8 0x532 0x997 0xa73e 0x532 0xb30 0xa6c3 0x532 0xcc9 0xa648 0x532 0xe62 0xa5cd 0x532 0xffb 0xa555 0x532 0x1194 0xa4e2 0x532 0x132d 0xa467 0x532 0x14c6 0xa3f3 0x532 0x165f 0xa385 0x53b 0x17f8 0xa318 0x546 0x1991 0xa2a5 0x546 0x1b2b 0xa233 0x546 0x1cc4 0xa1c7 0x55c 0x1e5d 0xa158 0x564 0x1ff6 0xa0e9 0x56b 0x218f 0xa07e 0x578 0x2328 0xa014 0x578 0x24c1 0x9faa 0x578 0x265a 0x9f52 0x58b 0x27f3 0x9f0e 0x5b6 0x298c 0x9ec2 0x5d7 0x2b25 0x9e4b 0x5c5 0x2cbf 0x9daf 0x5ad 0x2e58 0x9d1b 0x5c0 0x2ff1 0x9c98 0x5b8 0x318a 0x9c30 0x5b5 0x3323 0x9be3 0x5d1 0x34bc 0x9baa 0x5fa 0x3655 0x9b71 0x60a 0x37ee 0x9b2b 0x60e 0x3987 0x9ae1 0x61c 0x3b20 0x9a95 0x631 0x3cb9 0x9a42 0x640 0x3e53 0x99e8 0x640 0x3fec 0x9987 0x631 0x4185 0x991a 0x600 0x431e 0x98a3 0x5b8 0x44b7 0x982c 0x56b 0x4650 0x97c2 0x532 0x47e9 0x9770 0x532 0x4982 0x9725 0x51f 0x4b1b 0x96e4 0x522 0x4cb4 0x96a8 0x52a 0x4e4d 0x9669 0x514 0x4fe7 0x9637 0x514 0x5180 0x9606 0x514 0x5319 0x95d5 0x514 0x54b2 0x95a8 0x51f 0x564b 0x957d 0x52d 0x57e4 0x954c 0x514 0x597d 0x952b 0x52d 0x5b16 0x9504 0x532 0x5caf 0x94e0 0x532 0x5e48 0x94bc 0x532 0x5fe1 0x9495 0x534 0x617b 0x947d 0x544 0x6314 0x945d 0x546 0x64ad 0x943c 0x546 0x6646 0x941f 0x551 0x67df 0x9407 0x564 0x6978 0x93ee 0x564 0x6b11 0x93d5 0x564 0x6caa 0x93bd 0x564 0x6e43 0x93a0 0x564 0x6fdc 0x937f 0x55c 0x7175 0x935d 0x544 0x730f 0x9335 0x534 0x74a8 0x9313 0x51c 0x7641 0x92ed 0x514 0x77da 0x92c4 0x514 0x7973 0x929b 0x510 0x7b0c 0x9272 0x500 0x7ca5 0x9251 0x510 0x7e3e 0x9231 0x514 0x7fd7 0x920b 0x522 0x8170 0x91e0 0x532 0x8309 0x91ad 0x532 0x84a3 0x916b 0x532 0x863c 0x9138 0x532 0x87d5 0x9102 0x53d 0x896e 0x90be 0x546 0x8b07 0x9073 0x542 0x8ca0 0x9042 0x532 0x8e39 0x903a 0x55b 0x8fd2 0x902b 0x584 0x916b 0x9016 0x5ad 0x9304 0x8ff6 0x5db 0x949d 0x8fb0 0x609 0x9637 0x8ec2 0x5e1 0x97d0 0x8d18 0x616 0x9969 0x8ade 0x663 0x9b02 0x87d7 0x6e0 0x9c9b 0x830e 0x9a0 0x9e34 0x7a9e 0x1388>;
			battery1_profile_t2_num = <0x64>;
			battery1_profile_t2_col = <0x03>;
			battery1_profile_t2 = <0x00 0xa9f6 0x708 0x199 0xa963 0x708 0x332 0xa8dc 0x71b 0x4cb 0xa859 0x718 0x664 0xa7d9 0x708 0x7fd 0xa760 0x70b 0x997 0xa6ef 0x723 0xb30 0xa676 0x711 0xcc9 0xa5fb 0x708 0xe62 0xa584 0x708 0xffb 0xa511 0x708 0x1194 0xa49f 0x708 0x132d 0xa42c 0x708 0x14c6 0xa3ba 0x708 0x165f 0xa34c 0x715 0x17f8 0xa2df 0x726 0x1991 0xa26c 0x724 0x1b2b 0xa1fa 0x70b 0x1cc4 0xa190 0x71d 0x1e5d 0xa126 0x730 0x1ff6 0xa0b9 0x73a 0x218f 0xa049 0x73e 0x2328 0x9fe7 0x757 0x24c1 0x9f8c 0x758 0x265a 0x9f50 0x794 0x27f3 0x9f0a 0x7c4 0x298c 0x9ea0 0x7cb 0x2b25 0x9e0b 0x7ba 0x2cbf 0x9d57 0x7a2 0x2e58 0x9cb1 0x790 0x2ff1 0x9c2d 0x794 0x318a 0x9bc5 0x79e 0x3323 0x9b6e 0x7a2 0x34bc 0x9b2d 0x7ba 0x3655 0x9af3 0x7cb 0x37ee 0x9ab4 0x7e1 0x3987 0x9a6e 0x7ee 0x3b20 0x9a21 0x7e3 0x3cb9 0x99c6 0x7ba 0x3e53 0x995c 0x778 0x3fec 0x98f1 0x74b 0x4185 0x9887 0x718 0x431e 0x9823 0x6e5 0x44b7 0x97cc 0x6bf 0x4650 0x977a 0x6a6 0x47e9 0x9730 0x695 0x4982 0x96eb 0x690 0x4b1b 0x96aa 0x685 0x4cb4 0x966c 0x678 0x4e4d 0x963b 0x690 0x4fe7 0x9602 0x677 0x5180 0x95cf 0x672 0x5319 0x95a3 0x680 0x54b2 0x9577 0x687 0x564b 0x9547 0x672 0x57e4 0x951f 0x672 0x597d 0x94f6 0x688 0x5b16 0x94d3 0x690 0x5caf 0x94b2 0x697 0x5e48 0x9491 0x6a4 0x5fe1 0x9470 0x6a4 0x617b 0x9450 0x6bc 0x6314 0x942f 0x6c2 0x64ad 0x9413 0x6c2 0x6646 0x93fa 0x6c2 0x67df 0x93e1 0x6c2 0x6978 0x93c0 0x6c2 0x6b11 0x93a7 0x6ad 0x6caa 0x9394 0x6b3 0x6e43 0x9383 0x6c2 0x6fdc 0x9371 0x6c2 0x7175 0x9359 0x6c2 0x730f 0x9340 0x6c2 0x74a8 0x9322 0x6c2 0x7641 0x92fd 0x6b5 0x77da 0x92d4 0x6a4 0x7973 0x92ac 0x6a4 0x7b0c 0x928b 0x6a4 0x7ca5 0x926a 0x6c7 0x7e3e 0x9244 0x6e5 0x7fd7 0x9215 0x6f4 0x8170 0x91dd 0x6f7 0x8309 0x91a3 0x707 0x84a3 0x916a 0x708 0x863c 0x9131 0x725 0x87d5 0x90eb 0x746 0x896e 0x90a0 0x75c 0x8b07 0x9069 0x76e 0x8ca0 0x9050 0x797 0x8e39 0x903e 0x7e2 0x8fd2 0x9029 0x834 0x916b 0x9007 0x89f 0x9304 0x8fc7 0x930 0x949d 0x8f36 0x9b8 0x9637 0x8dbb 0xa0f 0x97d0 0x8bad 0xad2 0x9969 0x88f1 0xc4f 0x9b02 0x84f9 0xf61 0x9c9b 0x7f08 0x154a 0x9e34 0x7f08 0x154a>;
			battery1_profile_t3_num = <0x64>;
			battery1_profile_t3_col = <0x03>;
			battery1_profile_t3 = <0x00 0xa9f6 0xb40 0x199 0xa952 0xb40 0x332 0xa8bb 0xb40 0x4cb 0xa831 0xb40 0x664 0xa7ae 0xb38 0x7fd 0xa72d 0xb22 0x997 0xa6b4 0xb22 0xb30 0xa641 0xb37 0xcc9 0xa5c9 0xb30 0xe62 0xa54e 0xb1b 0xffb 0xa4d5 0xb0e 0x1194 0xa463 0xb0e 0x132d 0xa3f8 0xb0e 0x14c6 0xa388 0xb0e 0x165f 0xa31a 0xb0e 0x17f8 0xa2af 0xb13 0x1991 0xa244 0xb22 0x1b2b 0xa1d2 0xb22 0x1cc4 0xa168 0xb37 0x1e5d 0xa0fe 0xb40 0x1ff6 0xa094 0xb36 0x218f 0xa02c 0xb22 0x2328 0x9fd2 0xb22 0x24c1 0x9f90 0xb87 0x265a 0x9f4e 0xbfd 0x27f3 0x9ef0 0xc2e 0x298c 0x9e65 0xc0c 0x2b25 0x9db0 0xbd1 0x2cbf 0x9cf4 0xb7f 0x2e58 0x9c53 0xb50 0x2ff1 0x9bd3 0xb31 0x318a 0x9b68 0xb13 0x3323 0x9b09 0xaf4 0x34bc 0x9abf 0xb0c 0x3655 0x9a7d 0xb0e 0x37ee 0x9a36 0xb0e 0x3987 0x99e9 0xb02 0x3b20 0x9997 0xae5 0x3cb9 0x9945 0xabc 0x3e53 0x98eb 0xa94 0x3fec 0x9891 0xa6b 0x4185 0x9837 0xa42 0x431e 0x97e3 0xa22 0x44b7 0x979b 0xa11 0x4650 0x9751 0x9f8 0x47e9 0x9708 0x9e7 0x4982 0x96c9 0x9ed 0x4b1b 0x968c 0x9ef 0x4cb4 0x964e 0x9e6 0x4e4d 0x961d 0x9f6 0x4fe7 0x95e4 0x9e5 0x5180 0x95b1 0x9e2 0x5319 0x9585 0x9eb 0x54b2 0x955c 0x9ff 0x564b 0x9533 0xa16 0x57e4 0x950b 0xa26 0x597d 0x94e2 0xa28 0x5b16 0x94b9 0xa28 0x5caf 0x9494 0xa28 0x5e48 0x9473 0xa2d 0x5fe1 0x9452 0xa46 0x617b 0x943a 0xa56 0x6314 0x941b 0xa5a 0x64ad 0x93ff 0xa5a 0x6646 0x93e6 0xa5a 0x67df 0x93ce 0xa5c 0x6978 0x93be 0xa75 0x6b11 0x93b5 0xa9b 0x6caa 0x93a8 0xab4 0x6e43 0x9397 0xac8 0x6fdc 0x9387 0xae4 0x7175 0x9377 0xb0d 0x730f 0x935e 0xb35 0x74a8 0x9346 0xb5e 0x7641 0x9329 0xb87 0x77da 0x9308 0xbb0 0x7973 0x92e8 0xbdc 0x7b0c 0x92c7 0xc2e 0x7ca5 0x929f 0xc6b 0x7e3e 0x9277 0xcb3 0x7fd7 0x9248 0xcfd 0x8170 0x920f 0xd44 0x8309 0x91d5 0xda6 0x84a3 0x919c 0xe1f 0x863c 0x915d 0xe9a 0x87d5 0x9118 0xf29 0x896e 0x90d0 0xfd3 0x8b07 0x9090 0x1093 0x8ca0 0x9067 0x1199 0x8e39 0x9045 0x12d5 0x8fd2 0x901f 0x1480 0x916b 0x8fed 0x169f 0x9304 0x8fa2 0x1922 0x949d 0x8f0e 0x1c12 0x9637 0x8dc0 0x1f56 0x97d0 0x8bd8 0x2460 0x9969 0x8940 0x2bf8 0x9b02 0x8592 0x371c 0x9c9b 0x7ff7 0x4617 0x9e34 0x7a80 0x3ed0>;
			battery1_profile_t4_num = <0x64>;
			battery1_profile_t4_col = <0x03>;
			battery1_profile_t4 = <0x00 0xaa1e 0x1612 0x199 0xa941 0x1612 0x332 0xa884 0x1612 0x4cb 0xa7e2 0x1609 0x664 0xa752 0x15f6 0x7fd 0xa6c7 0x15da 0x997 0xa63b 0x15a0 0xb30 0xa5b8 0x1584 0xcc9 0xa535 0x1561 0xe62 0xa4b5 0x1538 0xffb 0xa43d 0x1514 0x1194 0xa3ca 0x1504 0x132d 0xa357 0x1514 0x14c6 0xa2e5 0x150b 0x165f 0xa272 0x1504 0x17f8 0xa200 0x14f6 0x1991 0xa18d 0x14cf 0x1b2b 0xa11b 0x14b7 0x1cc4 0xa0a8 0x14a5 0x1e5d 0xa04b 0x14c6 0x1ff6 0x9ffd 0x152f 0x218f 0x9fb2 0x15c0 0x2328 0x9f60 0x1612 0x24c1 0x9edd 0x15d9 0x265a 0x9e34 0x1559 0x27f3 0x9d7b 0x14d4 0x298c 0x9cc5 0x1454 0x2b25 0x9c1d 0x13d1 0x2cbf 0x9b9b 0x138f 0x2e58 0x9b26 0x1355 0x2ff1 0x9abf 0x1332 0x318a 0x9a67 0x1324 0x3323 0x9a1f 0x132d 0x34bc 0x99de 0x1356 0x3655 0x9994 0x1356 0x37ee 0x994b 0x1349 0x3987 0x9901 0x1342 0x3b20 0x98b5 0x133a 0x3cb9 0x9863 0x1322 0x3e53 0x9811 0x1312 0x3fec 0x97c7 0x1310 0x4185 0x977d 0x1310 0x431e 0x9737 0x1310 0x44b7 0x96f5 0x1314 0x4650 0x96b4 0x1324 0x47e9 0x967b 0x133d 0x4982 0x9641 0x134f 0x4b1b 0x9608 0x1364 0x4cb4 0x95cf 0x1374 0x4e4d 0x9597 0x1379 0x4fe7 0x956f 0x13a1 0x5180 0x953e 0x13b5 0x5319 0x9513 0x13d5 0x54b2 0x94ea 0x13fe 0x564b 0x94c1 0x1423 0x57e4 0x9498 0x143c 0x597d 0x9477 0x144c 0x5b16 0x9457 0x1463 0x5caf 0x943f 0x149b 0x5e48 0x942f 0x14ed 0x5fe1 0x941e 0x153c 0x617b 0x940e 0x1576 0x6314 0x93fd 0x15c5 0x64ad 0x93ed 0x1627 0x6646 0x93dd 0x16ab 0x67df 0x93cc 0x1740 0x6978 0x93bc 0x17a2 0x6b11 0x93ac 0x1846 0x6caa 0x939b 0x1909 0x6e43 0x9386 0x19cd 0x6fdc 0x936e 0x1a8e 0x7175 0x9355 0x1b58 0x730f 0x933d 0x1c0c 0x74a8 0x931d 0x1cec 0x7641 0x92fc 0x1de7 0x77da 0x92db 0x1ef7 0x7973 0x92b9 0x201f 0x7b0c 0x9290 0x2166 0x7ca5 0x9267 0x22ef 0x7e3e 0x9238 0x2471 0x7fd7 0x9207 0x260d 0x8170 0x91d3 0x27fb 0x8309 0x919a 0x2a65 0x84a3 0x9160 0x2cf3 0x863c 0x9127 0x2fef 0x87d5 0x90e8 0x332f 0x896e 0x90ab 0x36a3 0x8b07 0x9071 0x3a22 0x8ca0 0x9038 0x3d54 0x8e39 0x8ff7 0x4034 0x8fd2 0x8fb5 0x42c8 0x916b 0x8f61 0x450b 0x9304 0x8ee7 0x4712 0x949d 0x8e2a 0x490a 0x9637 0x8ce2 0x4b70 0x97d0 0x8ade 0x4ed4 0x9969 0x87f3 0x54d6 0x9b02 0x861a 0x58de 0x9c9b 0x861a 0x58de 0x9e34 0x861a 0x58de>;
		};
	};

	fragment@35 {
		target = <0xffffffff>;

		__overlay__ {
			charger = <0xffffffff>;
		};
	};

	fragment@36 {
		target = <0xffffffff>;

		__overlay__ {
			compatible = "mediatek, key_google_key-eint";
			interrupt-parent = <0xffffffff>;
			interrupts = <0x0f 0x08 0x0f 0x00>;
			deb-gpios = <0xffffffff 0x0f 0x00>;
			debounce = <0xfa00>;
			status = "okay";
		};
	};

	fragment@37 {
		target = <0xffffffff>;

		__overlay__ {
			hacpa-gpio = <0xffffffff 0x59 0x00>;
			pinctrl-names = "aud_clk_mosi_off\0aud_clk_mosi_on\0aud_clk_miso_off\0aud_clk_miso_on\0aud_dat_mosi_off\0aud_dat_mosi_on\0aud_dat_miso_off\0aud_dat_miso_on\0aud_smartpa_off\0aud_smartpa_on\0aud_pins_hacpa_off\0aud_pins_hacpa_on";
			pinctrl-0 = <0x37>;
			pinctrl-1 = <0x38>;
			pinctrl-2 = <0x39>;
			pinctrl-3 = <0x3a>;
			pinctrl-4 = <0x3b>;
			pinctrl-5 = <0x3c>;
			pinctrl-6 = <0x3d>;
			pinctrl-7 = <0x3e>;
			pinctrl-8 = <0x3f>;
			pinctrl-9 = <0x40>;
			pinctrl-10 = <0x41>;
			pinctrl-11 = <0x42>;
			status = "okay";
		};
	};

	fragment@38 {
		target = <0xffffffff>;

		__overlay__ {

			aud_clk_mosi_off {
				phandle = <0x37>;

				pins_cmd0_dat {
					pinmux = <0x8800>;
				};
			};

			aud_clk_mosi_on {
				phandle = <0x38>;

				pins_cmd0_dat {
					pinmux = <0x8801>;
				};
			};

			aud_clk_miso_off {
				phandle = <0x39>;

				pins_cmd0_dat {
					pinmux = <0x8c00>;
				};
			};

			aud_clk_miso_on {
				phandle = <0x3a>;

				pins_cmd0_dat {
					pinmux = <0x8c01>;
				};
			};

			aud_dat_mosi_off {
				phandle = <0x3b>;

				pins_cmd1_dat {
					pinmux = <0x8a00>;
					input-enable;
					slew-rate = <0x00>;
					bias-disable;
				};

				pins_cmd2_dat {
					pinmux = <0x8b00>;
					input-enable;
					slew-rate = <0x00>;
					bias-disable;
				};
			};

			aud_dat_mosi_on {
				phandle = <0x3c>;

				pins_cmd1_dat {
					pinmux = <0x8a01>;
				};

				pins_cmd2_dat {
					pinmux = <0x8b01>;
				};
			};

			aud_dat_miso_off {
				phandle = <0x3d>;

				pins_cmd1_dat {
					pinmux = <0x8e00>;
					input-enable;
					slew-rate = <0x00>;
					bias-disable;
				};

				pins_cmd2_dat {
					pinmux = <0x8f00>;
					input-enable;
					slew-rate = <0x00>;
					bias-disable;
				};
			};

			aud_dat_miso_on {
				phandle = <0x3e>;

				pins_cmd1_dat {
					pinmux = <0x8e01>;
				};

				pins_cmd2_dat {
					pinmux = <0x8f01>;
				};
			};

			aud_pins_smartpa_off {
				phandle = <0x3f>;

				pins_cmd0_dat {
					pinmux = <0x1100>;
				};

				pins_cmd1_dat {
					pinmux = <0x1200>;
				};

				pins_cmd2_dat {
					pinmux = <0x1300>;
				};

				pins_cmd3_dat {
					pinmux = <0x1400>;
				};
			};

			aud_pins_smartpa_on {
				phandle = <0x40>;

				pins_cmd0_dat {
					pinmux = <0x1106>;
				};

				pins_cmd1_dat {
					pinmux = <0x1206>;
				};

				pins_cmd2_dat {
					pinmux = <0x1306>;
				};

				pins_cmd3_dat {
					pinmux = <0x1406>;
				};
			};

			aud_pins_hacpa_off {
				phandle = <0x41>;

				pins_cmd0_dat {
					pinmux = <0x5900>;
					slew-rate = <0x01>;
					output-low;
				};
			};

			aud_pins_hacpa_on {
				phandle = <0x42>;

				pins_cmd0_dat {
					pinmux = <0x5900>;
					slew-rate = <0x01>;
					output-high;
				};
			};
		};
	};

	fragment@39 {
		target = <0xffffffff>;

		__overlay__ {
			mt6370,intr_gpio_num = <0x0b>;
			mt6370,intr_gpio = <0xffffffff 0x0b 0x00>;
		};
	};

	fragment@40 {
		target = <0xffffffff>;

		__overlay__ {
			charger = <0xffffffff>;
			battery_cv = <0x432380>;
			max_charger_voltage = <0x632ea0>;
			min_charger_voltage = <0x4630c0>;
			usb_charger_current_suspend = <0x00>;
			usb_charger_current_unconfigured = <0x11170>;
			usb_charger_current_configured = <0x7a120>;
			usb_charger_current = <0x7a120>;
			ac_charger_current = <0x1e8480>;
			ac_charger_input_current = <0x1e8480>;
			non_std_ac_charger_current = <0xf4240>;
			charging_host_charger_current = <0x16e360>;
			apple_1_0a_charger_current = <0x9eb10>;
			apple_2_1a_charger_current = "\0\f5";
			ta_ac_charger_current = <0x1e8480>;
			typec_limit_aicr = <0x1e8480>;
			enable_min_charge_temperature;
			min_charge_temperature = <0x00>;
			min_charge_temperature_plus_x_degree = <0x0a>;
			max_charge_temperature = <0x3c>;
			max_charge_temperature_minus_x_degree = <0x2d>;
			mmi,iterm-ma = <0x50>;
			mmi,mmi-temp-zones = <0x00 0x1068 0x324 0x00 0x0a 0x00 0x324 0x324 0x0f 0x1068 0x324 0x324 0x2d 0x00 0xbb8 0xaf0 0x3c 0x1068 0x7da 0x00>;
			mmi,enable-charging-limit;
			mmi,upper-limit-capacity = <0x41>;
			mmi,lower-limit-capacity = <0x3c>;
			mmi,vfloat-comp-uv = <0x4e20>;
		};
	};

	fragment@41 {
		target = <0xffffffff>;

		__overlay__ {
			mt6370pd,intr_gpio_num = <0x29>;
			mt6370pd,intr_gpio = <0xffffffff 0x29 0x00>;
		};
	};

	fragment@42 {
		target = <0xffffffff>;

		__overlay__ {
			bc12_sel = <0x01>;
		};
	};

	fragment@43 {
		target = <0xffffffff>;

		__overlay__ {
			status = "disable";
		};
	};

	fragment@44 {
		target = <0xffffffff>;

		__overlay__ {
			status = "disable";
		};
	};

	fragment@45 {
		target = <0xffffffff>;

		__overlay__ {
			status = "disable";
		};
	};

	fragment@46 {
		target = <0xffffffff>;

		__overlay__ {
			pd_vbus_upper_bound = <0x4c4b40>;
			sc_charger_current = <0x1e8480>;
			sc_input_current = <0x1e8480>;
		};
	};

	fragment@47 {
		target = <0xffffffff>;

		__overlay__ {

			fingerprint_irq {
				phandle = <0x43>;

				pins_cmd_dat {
					pinmux = <0xe00>;
					slew-rate = <0x00>;
					bias-disable;
				};
			};

			fingerprint_reset_high {
				phandle = <0x44>;

				pins_cmd_dat {
					pinmux = <0xaa00>;
					slew-rate = <0x01>;
					output-high;
				};
			};

			fingerprint_reset_low {
				phandle = <0x45>;

				pins_cmd_dat {
					pinmux = <0xaa00>;
					slew-rate = <0x01>;
					output-low;
				};
			};

			fingerprint_ldo1p8_high {
				phandle = <0x50>;

				pins_cmd_dat {
					pinmux = <0x9900>;
					slew-rate = <0x01>;
					output-high;
				};
			};

			fingerprint_ldo1p8_low {
				phandle = <0x51>;

				pins_cmd_dat {
					pinmux = <0x9900>;
					slew-rate = <0x01>;
					output-low;
				};
			};
		};
	};

	fragment@48 {
		target = <0xffffffff>;

		__overlay__ {

			fingerprint_int {
				compatible = "mediatek,fingerprint-fpc";
				fpc,enable-wakeup;
				interrupt-parent = <0xffffffff>;
				interrupts = <0x0e 0x01 0x0e 0x00>;
				pinctrl-names = "fingerprint_irq\0fingerprint_reset_high\0fingerprint_reset_low";
				pinctrl-0 = <0x43>;
				pinctrl-1 = <0x44>;
				pinctrl-2 = <0x45>;
				fpc,vdd = <0xffffffff 0x99 0x00>;
				fpc,rst = <0xffffffff 0xaa 0x00>;
				fpc,irq = <0xffffffff 0x0e 0x00>;
				status = "okay";
				phandle = <0x52>;
			};

			goodix_int {
				compatible = "mediatek,fingerprint-goodix";
				interrupt-parent = <0xffffffff>;
				interrupts = <0x0e 0x01 0x0e 0x00>;
				pinctrl-names = "fingerprint_irq\0fingerprint_reset_high\0fingerprint_reset_low";
				pinctrl-0 = <0x43>;
				pinctrl-1 = <0x44>;
				pinctrl-2 = <0x45>;
				int-gpios = <0xffffffff 0x0e 0x00>;
				status = "okay";
				phandle = <0x53>;
			};
		};
	};

	fragment@49 {
		target = <0xffffffff>;

		__overlay__ {
			#address-cells = <0x01>;
			#size-cells = <0x00>;
			mediatek,pad-select = <0x00 0x01>;
			tee-only;

			fpc_tee@0 {
				compatible = "fpc,fpc_spi";
				reg = <0x00>;
				fpc,enable-wakeup;
				spi-max-frequency = <0x7a1200>;
				netlink-event = <0x1f>;
				status = "okay";
			};

			goodix_tee@1 {
				status = "okay";
				compatible = "goodix,goodix-fp";
				reg = <0x01>;
				spi-max-frequency = <0x7a1200>;
				netlink-event = <0x1e>;
			};
		};
	};

	fragment@model {
		target-path = "/";

		__overlay__ {
			mot,model = "ellis";
			mot,board-id = <0x41 0xa100>;
		};
	};

	fragment@50 {
		target = <0xffffffff>;

		__overlay__ {
			rt-tcpc,vconn_supply = <0x00>;
			charger = <0xffffffff>;
		};
	};

	fragment@51 {
		target = <0xffffffff>;

		__overlay__ {
			sgm7220,intr_gpio = <0xffffffff 0x29 0x01>;
			sgm7220,intr_gpio_num = <0x29>;
			sgm7220,en_gpio = <0xffffffff 0x9f 0x00>;
		};
	};

	fragment@52 {
		target = <0xffffffff>;

		__overlay__ {

			adc_channel@ {
				compatible = "mediatek,adc_channel";
				mediatek,temperature0 = <0x00>;
				mediatek,temperature1 = <0x01>;
				mediatek,adc_fdd_rf_params_dynamic_custom_ch = <0x02>;
				status = "okay";
			};
		};
	};

	fragment@53 {
		target = <0xffffffff>;

		__overlay__ {
			io-channels = <0xffffffff 0x02>;
		};
	};

	fragment@54 {
		target = <0xffffffff>;

		__overlay__ {
			mediatek,clkbuf-quantity = <0x07>;
			mediatek,clkbuf-config = <0x02 0x01 0x01 0x02 0x00 0x00 0x00>;
			mediatek,clkbuf-driving-current = <0x01 0x01 0x01 0x01 0x01 0x01 0x01>;
			status = "okay";
		};
	};

	fragment@55 {
		target = <0xffffffff>;

		__overlay__ {
			#address-cells = <0x01>;
			#size-cells = <0x00>;
			clock-frequency = <0x61a80>;
			mediatek,use-push-pull;

			i2c_lcd_bias@3e {
				compatible = "mediatek,i2c_lcd_bias";
				reg = <0x3e>;
				status = "okay";
				phandle = <0x54>;
			};
		};
	};

	fragment@56 {
		target = <0xffffffff>;

		__overlay__ {
			#address-cells = <0x01>;
			#size-cells = <0x00>;
			clock-frequency = <0x61a80>;
			mediatek,use-open-drain;
		};
	};

	fragment@57 {
		target = <0xffffffff>;

		__overlay__ {
			#address-cells = <0x01>;
			#size-cells = <0x00>;
			clock-frequency = <0x61a80>;
			mediatek,use-open-drain;

			camera_main@40 {
				compatible = "mediatek,camera_main";
				reg = <0x40>;
				status = "okay";
				phandle = <0x55>;
			};

			camera_main_eeprom@50 {
				compatible = "mediatek,camera_main_eeprom";
				reg = <0x50>;
				status = "okay";
				phandle = <0x56>;
			};

			camera_main_af@18 {
				compatible = "mediatek,camera_main_af";
				reg = <0x18>;
				status = "okay";
				phandle = <0x57>;
			};

			ccu_sensor_i2c_2_hw@10 {
				compatible = "mediatek,ccu_sensor_i2c_2_hw";
				reg = <0x10>;
				status = "okay";
				phandle = <0x58>;
			};
		};
	};

	fragment@58 {
		target = <0xffffffff>;

		__overlay__ {
			#address-cells = <0x01>;
			#size-cells = <0x00>;
			clock-frequency = <0x61a80>;
			mediatek,use-open-drain;

			speaker_amp@34 {
				compatible = "mediatek,speaker_amp";
				reg = <0x34>;
				status = "okay";
				phandle = <0x59>;
			};

			slave_charger@4b {
				compatible = "mediatek,slave_charger";
				reg = <0x4b>;
				status = "okay";
				phandle = <0x5a>;
			};

			nfc@08 {
				compatible = "mediatek,nfc";
				reg = <0x08>;
				status = "okay";
				phandle = <0x5b>;
			};

			ext_buck_lp4@57 {
				compatible = "mediatek,ext_buck_lp4";
				reg = <0x57>;
				status = "okay";
				phandle = <0x5c>;
			};

			ext_buck_lp4x@50 {
				compatible = "mediatek,ext_buck_lp4x";
				reg = <0x50>;
				status = "okay";
				phandle = <0x5d>;
			};
		};
	};

	fragment@59 {
		target = <0xffffffff>;

		__overlay__ {
			#address-cells = <0x01>;
			#size-cells = <0x00>;
			clock-frequency = <0x61a80>;
			mediatek,use-open-drain;

			camera_main_two@7a {
				compatible = "mediatek,camera_main_two";
				reg = <0x7a>;
				status = "okay";
				phandle = <0x5e>;
			};

			camera_sub@2d {
				compatible = "mediatek,camera_sub";
				reg = <0x2d>;
				status = "okay";
				phandle = <0x5f>;
			};

			camera_sub_eeprom@52 {
				compatible = "mediatek,camera_sub_eeprom";
				reg = <0x52>;
				status = "okay";
				phandle = <0x60>;
			};

			ccu_sensor_i2c_4_hw@11 {
				compatible = "mediatek,ccu_sensor_i2c_4_hw";
				reg = <0x11>;
				status = "okay";
				phandle = <0x61>;
			};
		};
	};

	fragment@60 {
		target = <0xffffffff>;

		__overlay__ {
			#address-cells = <0x01>;
			#size-cells = <0x00>;
			clock-frequency = <0x61a80>;
			mediatek,use-open-drain;

			subpmic_pmu@34 {
				compatible = "mediatek,subpmic_pmu";
				reg = <0x34>;
				status = "okay";
				phandle = <0x62>;
			};

			usb_type_c@4e {
				compatible = "mediatek,usb_type_c";
				reg = <0x4e>;
				status = "okay";
				phandle = <0x63>;
			};

			usb_type_c_sgm@47 {
				compatible = "mediatek,usb_type_c_sgm";
				reg = <0x47>;
				status = "okay";
				phandle = <0x64>;
			};
		};
	};

	fragment@61 {
		target = <0xffffffff>;

		__overlay__ {
			#address-cells = <0x01>;
			#size-cells = <0x00>;
			clock-frequency = <0x61a80>;
			mediatek,use-open-drain;

			camera_main_two_eeprom@50 {
				compatible = "mediatek,camera_main_two_eeprom";
				reg = <0x50>;
				status = "okay";
				phandle = <0x65>;
			};

			camera_main_two_af@0c {
				compatible = "mediatek,camera_main_two_af";
				reg = <0x0c>;
				status = "okay";
				phandle = <0x66>;
			};

			ext_buck_vgpu@55 {
				compatible = "mediatek,ext_buck_vgpu";
				reg = <0x55>;
				status = "okay";
				phandle = <0x67>;
			};
		};
	};

	fragment@62 {
		target = <0xffffffff>;

		__overlay__ {
			#address-cells = <0x01>;
			#size-cells = <0x00>;
			clock-frequency = <0x61a80>;
			mediatek,use-open-drain;
		};
	};

	fragment@63 {
		target = <0xffffffff>;

		__overlay__ {
			#address-cells = <0x01>;
			#size-cells = <0x00>;
			clock-frequency = <0x61a80>;
			mediatek,use-open-drain;
		};
	};

	fragment@64 {
		target = <0xffffffff>;

		__overlay__ {
			#address-cells = <0x01>;
			#size-cells = <0x00>;
			clock-frequency = <0x61a80>;
			mediatek,use-open-drain;
		};
	};

	fragment@65 {
		target = <0xffffffff>;

		__overlay__ {
			GPIO_SIM2_SIO = <0xffffffff 0x23 0x00>;
			GPIO_SIM2_SRST = <0xffffffff 0x24 0x00>;
			GPIO_SIM2_SCLK = <0xffffffff 0x25 0x00>;
			GPIO_SIM1_SCLK = <0xffffffff 0x26 0x00>;
			GPIO_SIM1_SRST = <0xffffffff 0x27 0x00>;
			GPIO_SIM1_SIO = <0xffffffff 0x28 0x00>;
			GPIO_SIM1_HOT_PLUG = <0xffffffff 0x2f 0x00>;
		};
	};

	fragment@66 {
		target = <0xffffffff>;

		__overlay__ {
			gpio_init_default = <0x00 0x00 0x00 0x00 0x01 0x01 0x01 0x01 0x00 0x00 0x00 0x00 0x00 0x01 0x02 0x00 0x00 0x00 0x01 0x01 0x01 0x03 0x00 0x00 0x00 0x01 0x01 0x01 0x04 0x02 0x00 0x00 0x01 0x00 0x00 0x05 0x02 0x01 0x00 0x00 0x00 0x00 0x06 0x02 0x01 0x00 0x00 0x00 0x00 0x07 0x02 0x01 0x00 0x00 0x00 0x00 0x08 0x07 0x00 0x00 0x01 0x01 0x00 0x09 0x00 0x00 0x00 0x01 0x01 0x00 0x0a 0x00 0x00 0x00 0x00 0x00 0x00 0x0b 0x00 0x00 0x00 0x01 0x01 0x00 0x0c 0x00 0x00 0x00 0x01 0x01 0x00 0x0d 0x00 0x01 0x00 0x01 0x01 0x00 0x0e 0x00 0x00 0x00 0x01 0x00 0x01 0x0f 0x00 0x00 0x00 0x01 0x01 0x00 0x10 0x00 0x01 0x00 0x01 0x01 0x00 0x11 0x06 0x00 0x00 0x01 0x00 0x00 0x12 0x06 0x01 0x00 0x00 0x00 0x00 0x13 0x06 0x01 0x00 0x00 0x00 0x00 0x14 0x06 0x01 0x00 0x00 0x00 0x00 0x15 0x01 0x00 0x00 0x00 0x00 0x00 0x16 0x01 0x00 0x00 0x00 0x00 0x00 0x17 0x01 0x01 0x00 0x00 0x00 0x00 0x18 0x01 0x01 0x00 0x00 0x00 0x00 0x19 0x01 0x00 0x00 0x01 0x01 0x01 0x1a 0x01 0x00 0x00 0x00 0x00 0x01 0x1b 0x01 0x00 0x00 0x00 0x00 0x01 0x1c 0x01 0x00 0x00 0x01 0x01 0x01 0x1d 0x01 0x01 0x00 0x00 0x00 0x01 0x1e 0x01 0x00 0x00 0x01 0x01 0x01 0x1f 0x01 0x00 0x00 0x01 0x01 0x01 0x20 0x01 0x00 0x00 0x01 0x01 0x01 0x21 0x01 0x00 0x00 0x01 0x01 0x01 0x22 0x01 0x00 0x00 0x01 0x01 0x01 0x23 0x01 0x00 0x00 0x01 0x01 0x00 0x24 0x01 0x01 0x00 0x00 0x00 0x00 0x25 0x01 0x01 0x00 0x00 0x00 0x00 0x26 0x01 0x01 0x00 0x00 0x00 0x00 0x27 0x01 0x01 0x00 0x00 0x00 0x00 0x28 0x01 0x00 0x00 0x01 0x01 0x00 0x29 0x00 0x00 0x00 0x01 0x01 0x00 0x2a 0x00 0x00 0x00 0x01 0x00 0x00 0x2b 0x01 0x01 0x00 0x00 0x00 0x00 0x2c 0x01 0x00 0x00 0x01 0x00 0x00 0x2d 0x01 0x01 0x00 0x00 0x00 0x00 0x2e 0x00 0x00 0x00 0x01 0x00 0x00 0x2f 0x01 0x00 0x00 0x01 0x01 0x00 0x30 0x01 0x00 0x00 0x01 0x01 0x01 0x31 0x01 0x00 0x00 0x01 0x01 0x01 0x32 0x01 0x00 0x00 0x01 0x01 0x01 0x33 0x01 0x00 0x00 0x01 0x01 0x01 0x34 0x01 0x01 0x00 0x01 0x00 0x00 0x35 0x01 0x01 0x00 0x01 0x00 0x00 0x36 0x01 0x01 0x00 0x01 0x00 0x00 0x37 0x01 0x01 0x00 0x01 0x00 0x00 0x38 0x01 0x01 0x00 0x01 0x00 0x00 0x39 0x01 0x01 0x00 0x01 0x00 0x00 0x3a 0x00 0x00 0x00 0x01 0x00 0x00 0x3b 0x01 0x00 0x00 0x01 0x00 0x00 0x3c 0x01 0x00 0x00 0x01 0x00 0x00 0x3d 0x01 0x00 0x00 0x01 0x00 0x00 0x3e 0x01 0x00 0x00 0x01 0x00 0x00 0x3f 0x01 0x00 0x00 0x01 0x00 0x00 0x40 0x01 0x00 0x00 0x01 0x00 0x00 0x41 0x01 0x00 0x00 0x01 0x00 0x00 0x42 0x01 0x00 0x00 0x01 0x00 0x00 0x43 0x01 0x00 0x00 0x01 0x00 0x00 0x44 0x01 0x00 0x00 0x01 0x00 0x00 0x45 0x00 0x00 0x00 0x00 0x00 0x00 0x46 0x01 0x01 0x00 0x01 0x00 0x00 0x47 0x01 0x01 0x00 0x01 0x00 0x00 0x48 0x01 0x01 0x00 0x01 0x00 0x00 0x49 0x01 0x01 0x00 0x01 0x00 0x00 0x4a 0x01 0x01 0x00 0x01 0x00 0x00 0x4b 0x01 0x01 0x00 0x01 0x00 0x00 0x4c 0x01 0x01 0x00 0x01 0x00 0x00 0x4d 0x01 0x01 0x00 0x01 0x00 0x00 0x4e 0x01 0x01 0x00 0x01 0x00 0x00 0x4f 0x01 0x00 0x00 0x01 0x00 0x00 0x50 0x01 0x00 0x00 0x01 0x00 0x00 0x51 0x01 0x00 0x00 0x01 0x01 0x01 0x52 0x01 0x00 0x00 0x01 0x01 0x01 0x53 0x01 0x00 0x00 0x01 0x01 0x01 0x54 0x01 0x00 0x00 0x01 0x01 0x01 0x55 0x01 0x01 0x00 0x01 0x00 0x00 0x56 0x01 0x01 0x00 0x01 0x00 0x00 0x57 0x00 0x01 0x01 0x00 0x00 0x00 0x58 0x00 0x01 0x00 0x01 0x00 0x00 0x59 0x00 0x01 0x00 0x01 0x00 0x00 0x5a 0x02 0x01 0x00 0x00 0x00 0x00 0x5b 0x00 0x01 0x00 0x01 0x00 0x00 0x5c 0x00 0x01 0x00 0x00 0x00 0x00 0x5d 0x01 0x00 0x00 0x01 0x01 0x00 0x5e 0x01 0x00 0x00 0x01 0x01 0x00 0x5f 0x01 0x00 0x00 0x01 0x01 0x00 0x60 0x01 0x01 0x00 0x00 0x00 0x00 0x61 0x00 0x01 0x00 0x00 0x00 0x00 0x62 0x00 0x01 0x00 0x00 0x00 0x00 0x63 0x00 0x01 0x00 0x00 0x00 0x00 0x64 0x00 0x01 0x00 0x00 0x00 0x00 0x65 0x00 0x01 0x00 0x00 0x00 0x00 0x66 0x00 0x01 0x00 0x00 0x00 0x00 0x67 0x01 0x00 0x00 0x01 0x01 0x01 0x68 0x01 0x00 0x00 0x01 0x01 0x01 0x69 0x01 0x00 0x00 0x01 0x01 0x01 0x6a 0x01 0x00 0x00 0x01 0x01 0x01 0x6b 0x02 0x01 0x00 0x00 0x00 0x00 0x6c 0x00 0x01 0x00 0x00 0x00 0x00 0x6d 0x00 0x01 0x00 0x00 0x00 0x00 0x6e 0x01 0x00 0x00 0x01 0x00 0x00 0x6f 0x01 0x00 0x00 0x01 0x00 0x00 0x70 0x01 0x01 0x00 0x01 0x00 0x00 0x71 0x00 0x00 0x00 0x01 0x00 0x00 0x72 0x00 0x00 0x00 0x01 0x00 0x00 0x73 0x00 0x00 0x00 0x01 0x00 0x00 0x74 0x00 0x00 0x00 0x01 0x00 0x00 0x75 0x00 0x00 0x00 0x01 0x00 0x00 0x76 0x00 0x00 0x00 0x01 0x00 0x00 0x77 0x00 0x00 0x00 0x01 0x00 0x00 0x78 0x00 0x00 0x00 0x01 0x00 0x00 0x79 0x00 0x00 0x00 0x01 0x00 0x00 0x7a 0x01 0x00 0x00 0x01 0x01 0x01 0x7b 0x01 0x00 0x00 0x01 0x01 0x01 0x7c 0x01 0x01 0x00 0x00 0x00 0x01 0x7d 0x01 0x00 0x00 0x01 0x01 0x01 0x7e 0x01 0x00 0x00 0x01 0x01 0x01 0x7f 0x01 0x00 0x00 0x01 0x01 0x01 0x80 0x01 0x00 0x00 0x01 0x01 0x01 0x81 0x01 0x00 0x00 0x01 0x01 0x01 0x82 0x01 0x00 0x00 0x01 0x01 0x01 0x83 0x01 0x00 0x00 0x01 0x00 0x01 0x84 0x01 0x00 0x00 0x01 0x01 0x01 0x85 0x01 0x01 0x01 0x00 0x00 0x01 0x86 0x01 0x00 0x00 0x01 0x00 0x01 0x87 0x01 0x01 0x00 0x00 0x00 0x00 0x88 0x01 0x01 0x00 0x00 0x00 0x00 0x89 0x01 0x01 0x00 0x00 0x00 0x00 0x8a 0x01 0x01 0x00 0x00 0x00 0x00 0x8b 0x01 0x01 0x00 0x00 0x00 0x00 0x8c 0x01 0x00 0x00 0x01 0x00 0x00 0x8d 0x01 0x00 0x00 0x01 0x00 0x00 0x8e 0x01 0x00 0x00 0x01 0x00 0x00 0x8f 0x01 0x00 0x00 0x01 0x00 0x00 0x90 0x01 0x00 0x00 0x01 0x00 0x00 0x91 0x01 0x01 0x01 0x00 0x00 0x00 0x92 0x01 0x00 0x00 0x01 0x00 0x00 0x93 0x01 0x01 0x00 0x00 0x00 0x00 0x94 0x01 0x01 0x00 0x00 0x00 0x00 0x95 0x01 0x01 0x00 0x00 0x00 0x00 0x96 0x03 0x01 0x00 0x01 0x01 0x00 0x97 0x03 0x01 0x00 0x00 0x00 0x00 0x98 0x03 0x01 0x00 0x01 0x01 0x00 0x99 0x05 0x01 0x00 0x00 0x00 0x00 0x9a 0x00 0x01 0x00 0x00 0x00 0x00 0x9b 0x07 0x01 0x00 0x00 0x00 0x00 0x9c 0x07 0x00 0x00 0x01 0x00 0x00 0x9d 0x07 0x00 0x00 0x01 0x00 0x00 0x9e 0x07 0x00 0x00 0x01 0x00 0x00 0x9f 0x00 0x01 0x00 0x00 0x00 0x00 0xa0 0x00 0x01 0x00 0x00 0x00 0x00 0xa1 0x01 0x00 0x00 0x01 0x01 0x01 0xa2 0x01 0x00 0x00 0x01 0x01 0x01 0xa3 0x00 0x00 0x00 0x00 0x00 0x00 0xa4 0x00 0x01 0x00 0x00 0x00 0x00 0xa5 0x00 0x01 0x01 0x01 0x01 0x00 0xa6 0x00 0x00 0x00 0x01 0x00 0x00 0xa7 0x00 0x00 0x00 0x01 0x00 0x00 0xa8 0x00 0x01 0x00 0x00 0x00 0x00 0xa9 0x00 0x01 0x00 0x00 0x00 0x00 0xaa 0x00 0x01 0x01 0x01 0x00 0x01 0xab 0x00 0x00 0x00 0x01 0x00 0x00 0xac 0x00 0x01 0x01 0x00 0x00 0x00 0xad 0x00 0x01 0x00 0x00 0x00 0x00 0xae 0x00 0x01 0x01 0x00 0x00 0x00 0xaf 0x00 0x01 0x01 0x00 0x00 0x00 0xb0 0x00 0x01 0x00 0x00 0x00 0x00 0xb1 0x00 0x01 0x00 0x00 0x00 0x00 0xb2 0x00 0x01 0x00 0x00 0x00 0x00 0xb3 0x00 0x00 0x00 0x01 0x00 0x00>;
		};
	};

	fragment@67 {
		target = <0xffffffff>;

		__overlay__ {
			interrupt-parent = <0xffffffff>;
			interrupts = <0x00 0x08 0x00 0x00>;
			status = "okay";
		};
	};

	fragment@68 {
		target = <0xffffffff>;

		__overlay__ {
			interrupt-parent = <0xffffffff>;
			interrupts = <0x01 0x02 0x01 0x00>;
			status = "okay";
		};
	};

	fragment@69 {
		target = <0xffffffff>;

		__overlay__ {
			interrupt-parent = <0xffffffff>;
			interrupts = <0x02 0x08 0x02 0x00>;
			deb-gpios = <0xffffffff 0x02 0x00>;
			debounce = <0x7d000>;
			status = "okay";
		};
	};

	fragment@70 {
		target = <0xffffffff>;

		__overlay__ {
			interrupt-parent = <0xffffffff>;
			interrupts = <0x0a 0x02 0x0a 0x00>;
			status = "okay";
		};
	};

	fragment@71 {
		target = <0xffffffff>;

		__overlay__ {
			interrupt-parent = <0xffffffff>;
			interrupts = <0x0b 0x02 0x0b 0x00>;
			status = "okay";
		};
	};

	fragment@72 {
		target = <0xffffffff>;

		__overlay__ {
			interrupt-parent = <0xffffffff>;
			interrupts = <0x0e 0x01 0x0e 0x00>;
			status = "okay";
		};
	};

	fragment@73 {
		target = <0xffffffff>;

		__overlay__ {
			interrupt-parent = <0xffffffff>;
			interrupts = <0x29 0x02 0x29 0x00>;
			status = "okay";
		};
	};

	fragment@74 {
		target = <0xffffffff>;

		__overlay__ {
			interrupt-parent = <0xffffffff>;
			interrupts = <0x2c 0x01 0x2c 0x01>;
			status = "okay";
		};
	};

	fragment@75 {
		target = <0xffffffff>;

		__overlay__ {
			interrupt-parent = <0xffffffff>;
			interrupts = <0x45 0x04 0x45 0x00>;
			deb-gpios = <0xffffffff 0x45 0x00>;
			debounce = <0x7d000>;
			status = "okay";
		};
	};

	fragment@76 {
		target = <0xffffffff>;

		__overlay__ {
			interrupt-parent = <0xffffffff>;
			interrupts = <0x90 0x04 0x90 0x01>;
			status = "okay";
		};
	};

	fragment@77 {
		target = <0xffffffff>;

		__overlay__ {
			compatible = "mediatek,md1_sim1_hot_plug_eint-eint";
			interrupts = <0x00 0x08>;
			debounce = <0x00 0x2710>;
			dedicated = <0x00 0x00>;
			src_pin = <0x00 0x01>;
			sockettype = <0x00 0x00>;
			status = "okay";
		};
	};

	fragment@78 {
		target = <0xffffffff>;

		__overlay__ {
			regulator-name = "vcama";
			regulator-default-on = <0x01>;
			status = "okay";
		};
	};

	fragment@79 {
		target = <0xffffffff>;

		__overlay__ {
			regulator-name = "vsim1";
			regulator-default-on = <0x01>;
			status = "okay";
		};
	};

	fragment@80 {
		target = <0xffffffff>;

		__overlay__ {
			regulator-name = "vsim2";
			regulator-default-on = <0x01>;
			status = "okay";
		};
	};

	fragment@81 {
		target = <0xffffffff>;

		__overlay__ {
			regulator-name = "vcamd";
			regulator-default-on = <0x01>;
			status = "okay";
		};
	};

	fragment@82 {
		target = <0xffffffff>;

		__overlay__ {
			regulator-name = "vcamio";
			regulator-default-on = <0x01>;
			status = "okay";
		};
	};

	fragment@83 {
		target = <0xffffffff>;

		__overlay__ {
			regulator-name = "vldo28";
			regulator-default-on = <0x01>;
			status = "okay";
		};
	};

	fragment@84 {
		target = <0xffffffff>;

		__overlay__ {
			vcamd_main2-supply = <0xffffffff>;
			vcamio-supply = <0xffffffff>;
			vcamio_sub-supply = <0xffffffff>;
			vcamio_main2-supply = <0xffffffff>;
			vcamaf-supply = <0xffffffff>;
			vcamaf_sub-supply = <0xffffffff>;
			vcamaf_main2-supply = <0xffffffff>;
			status = "okay";
		};
	};

	fragment@85 {
		target = <0xffffffff>;

		__overlay__ {
			status = "okay";
		};
	};

	fragment@86 {
		target = <0xffffffff>;

		__overlay__ {
			mediatek,kpd-key-debounce = <0x400>;
			mediatek,kpd-sw-pwrkey = <0x74>;
			mediatek,kpd-hw-pwrkey = <0x08>;
			mediatek,kpd-sw-rstkey = <0x73>;
			mediatek,kpd-hw-rstkey = <0x11>;
			mediatek,kpd-use-extend-type = <0x00>;
			mediatek,kpd-hw-map-num = <0x48>;
			mediatek,kpd-hw-init-map = <0x73 0x72 0x00 0x00 0x00 0x00 0x00 0x00 0x00 0x00 0x00 0x00 0x00 0x00 0x00 0x00 0x00 0x00 0x00 0x00 0x00 0x00 0x00 0x00 0x00 0x00 0x00 0x00 0x00 0x00 0x00 0x00 0x00 0x00 0x00 0x00 0x00 0x00 0x00 0x00 0x00 0x00 0x00 0x00 0x00 0x00 0x00 0x00 0x00 0x00 0x00 0x00 0x00 0x00 0x00 0x00 0x00 0x00 0x00 0x00 0x00 0x00 0x00 0x00 0x00 0x00 0x00 0x00 0x00 0x00 0x00 0x00>;
			mediatek,kpd-pwrkey-eint-gpio = <0x00>;
			mediatek,kpd-pwkey-gpio-din = <0x00>;
			mediatek,kpd-hw-dl-key0 = <0x11>;
			mediatek,kpd-hw-dl-key1 = <0x01>;
			mediatek,kpd-hw-dl-key2 = <0x08>;
			mediatek,kpd-hw-recovery-key = <0x11>;
			mediatek,kpd-hw-factory-key = <0x01>;
			status = "okay";
		};
	};

	__symbols__ {
		camera_pins_cam0_mclk_on = "/fragment@3/__overlay__/camera_pins_cam0_mclk_on";
		camera_pins_cam0_mclk_off = "/fragment@3/__overlay__/camera_pins_cam0_mclk_off";
		camera_pins_cam1_mclk_on = "/fragment@3/__overlay__/camera_pins_cam1_mclk_on";
		camera_pins_cam1_mclk_off = "/fragment@3/__overlay__/camera_pins_cam1_mclk_off";
		camera_pins_cam2_mclk_on = "/fragment@3/__overlay__/camera_pins_cam2_mclk_on";
		camera_pins_cam2_mclk_off = "/fragment@3/__overlay__/camera_pins_cam2_mclk_off";
		camera_pins_cam0_rst0 = "/fragment@3/__overlay__/cam0@0";
		camera_pins_cam0_rst1 = "/fragment@3/__overlay__/cam0@1";
		camera_pins_cam0_pnd0 = "/fragment@3/__overlay__/cam0@2";
		camera_pins_cam0_pnd1 = "/fragment@3/__overlay__/cam0@3";
		camera_pins_cam1_rst0 = "/fragment@3/__overlay__/cam1@0";
		camera_pins_cam1_rst1 = "/fragment@3/__overlay__/cam1@1";
		camera_pins_cam1_pnd0 = "/fragment@3/__overlay__/cam1@2";
		camera_pins_cam1_pnd1 = "/fragment@3/__overlay__/cam1@3";
		camera_pins_cam2_rst0 = "/fragment@3/__overlay__/cam2@0";
		camera_pins_cam2_rst1 = "/fragment@3/__overlay__/cam2@1";
		camera_pins_cam2_pnd0 = "/fragment@3/__overlay__/cam2@2";
		camera_pins_cam2_pnd1 = "/fragment@3/__overlay__/cam2@3";
		camera_pins_cam_ldo_rear_vcama_0 = "/fragment@3/__overlay__/cam0@vcama0";
		camera_pins_cam_ldo_rear_vcama_1 = "/fragment@3/__overlay__/cam0@vcama1";
		camera_pins_cam_ldo_sub_vcama_0 = "/fragment@3/__overlay__/cam1@vcama0";
		camera_pins_cam_ldo_sub_vcama_1 = "/fragment@3/__overlay__/cam1@vcama1";
		camera_pins_cam_ldo_rear2_vcama_0 = "/fragment@3/__overlay__/cam2@vcama0";
		camera_pins_cam_ldo_rear2_vcama_1 = "/fragment@3/__overlay__/cam2@vcama1";
		camera_pins_default = "/fragment@3/__overlay__/camdefault";
		flash_default = "/fragment@5/__overlay__/flash_default_cfg";
		flash_en_pin0 = "/fragment@5/__overlay__/flash_en_pin0";
		flash_en_pin1 = "/fragment@5/__overlay__/flash_en_pin1";
		torch_en_pin0 = "/fragment@5/__overlay__/torch_en_pin0";
		torch_en_pin1 = "/fragment@5/__overlay__/torch_en_pin1";
		ctp_pins_default = "/fragment@9/__overlay__/eint0default";
		ctp_pins_eint_as_int = "/fragment@9/__overlay__/eint@0";
		ctp_pins_eint_output0 = "/fragment@9/__overlay__/eintoutput0";
		ctp_pins_eint_output1 = "/fragment@9/__overlay__/eintoutput1";
		ctp_pins_rst_output0 = "/fragment@9/__overlay__/rstoutput0";
		ctp_pins_rst_output1 = "/fragment@9/__overlay__/rstoutput1";
		bq2560x_charger = "/fragment@13/__overlay__/bq25601@6B";
		bq2560x_charger_3rd = "/fragment@13/__overlay__/bq25601@3B";
		led0 = "/fragment@15/__overlay__/led@0";
		led1 = "/fragment@15/__overlay__/led@1";
		led2 = "/fragment@15/__overlay__/led@2";
		led3 = "/fragment@15/__overlay__/led@3";
		led4 = "/fragment@15/__overlay__/led@4";
		led5 = "/fragment@15/__overlay__/led@5";
		led6 = "/fragment@15/__overlay__/led@6";
		led7 = "/fragment@15/__overlay__/led@7";
		vibrator0 = "/fragment@15/__overlay__/vibrator@0";
		usb_phy_init = "/fragment@15/__overlay__/usb_phy_init";
		mtkfb_pins_lcm_reset0 = "/fragment@17/__overlay__/lcm_rst_out0_gpio";
		mtkfb_pins_lcm_reset1 = "/fragment@17/__overlay__/lcm_rst_out1_gpio";
		mtkfb_pins_lcd_bias_enp0 = "/fragment@17/__overlay__/lcd_bias_enp0_gpio";
		mtkfb_pins_lcd_bias_enp1 = "/fragment@17/__overlay__/lcd_bias_enp1_gpio";
		mtkfb_pins_lcd_bias_enn0 = "/fragment@17/__overlay__/lcd_bias_enn0_gpio";
		mtkfb_pins_lcd_bias_enn1 = "/fragment@17/__overlay__/lcd_bias_enn1_gpio";
		mtkfb_pins_lcm_pwr_en_out0 = "/fragment@17/__overlay__/lcm_pwr_en_out0_gpio";
		mtkfb_pins_lcm_pwr_en_out1 = "/fragment@17/__overlay__/lcm_pwr_en_out1_gpio";
		mtkfb_pins_default = "/fragment@17/__overlay__/dispdefault";
		consys_pins_default = "/fragment@23/__overlay__/consys_default";
		gpslna_pins_init = "/fragment@23/__overlay__/gpslna@0";
		gpslna_pins_oh = "/fragment@23/__overlay__/gpslna@1";
		gpslna_pins_ol = "/fragment@23/__overlay__/gpslna@2";
		kpd_pins_default = "/fragment@26/__overlay__/kpdgpiodefault";
		accdet_pins_default = "/fragment@29/__overlay__/accdetdefault";
		accdet_pins_eint_as_int = "/fragment@29/__overlay__/accdeteint@0";
		aud_clk_mosi_off = "/fragment@38/__overlay__/aud_clk_mosi_off";
		aud_clk_mosi_on = "/fragment@38/__overlay__/aud_clk_mosi_on";
		aud_clk_miso_off = "/fragment@38/__overlay__/aud_clk_miso_off";
		aud_clk_miso_on = "/fragment@38/__overlay__/aud_clk_miso_on";
		aud_dat_mosi_off = "/fragment@38/__overlay__/aud_dat_mosi_off";
		aud_dat_mosi_on = "/fragment@38/__overlay__/aud_dat_mosi_on";
		aud_dat_miso_off = "/fragment@38/__overlay__/aud_dat_miso_off";
		aud_dat_miso_on = "/fragment@38/__overlay__/aud_dat_miso_on";
		aud_pins_smartpa_off = "/fragment@38/__overlay__/aud_pins_smartpa_off";
		aud_pins_smartpa_on = "/fragment@38/__overlay__/aud_pins_smartpa_on";
		aud_pins_hacpa_off = "/fragment@38/__overlay__/aud_pins_hacpa_off";
		aud_pins_hacpa_on = "/fragment@38/__overlay__/aud_pins_hacpa_on";
		fingerprint_irq = "/fragment@47/__overlay__/fingerprint_irq";
		fingerprint_reset_high = "/fragment@47/__overlay__/fingerprint_reset_high";
		fingerprint_reset_low = "/fragment@47/__overlay__/fingerprint_reset_low";
		fingerprint_ldo1p8_high = "/fragment@47/__overlay__/fingerprint_ldo1p8_high";
		fingerprint_ldo1p8_low = "/fragment@47/__overlay__/fingerprint_ldo1p8_low";
		fingerprint_int = "/fragment@48/__overlay__/fingerprint_int";
		goodix_int = "/fragment@48/__overlay__/goodix_int";
		i2c_lcd_bias_mtk = "/fragment@55/__overlay__/i2c_lcd_bias@3e";
		camera_main_mtk = "/fragment@57/__overlay__/camera_main@40";
		camera_main_eeprom_mtk = "/fragment@57/__overlay__/camera_main_eeprom@50";
		camera_main_af_mtk = "/fragment@57/__overlay__/camera_main_af@18";
		ccu_sensor_i2c_2_hw_mtk = "/fragment@57/__overlay__/ccu_sensor_i2c_2_hw@10";
		speaker_amp_mtk = "/fragment@58/__overlay__/speaker_amp@34";
		slave_charger_mtk = "/fragment@58/__overlay__/slave_charger@4b";
		nfc_mtk = "/fragment@58/__overlay__/nfc@08";
		ext_buck_lp4_mtk = "/fragment@58/__overlay__/ext_buck_lp4@57";
		ext_buck_lp4x_mtk = "/fragment@58/__overlay__/ext_buck_lp4x@50";
		camera_main_two_mtk = "/fragment@59/__overlay__/camera_main_two@7a";
		camera_sub_mtk = "/fragment@59/__overlay__/camera_sub@2d";
		camera_sub_eeprom_mtk = "/fragment@59/__overlay__/camera_sub_eeprom@52";
		ccu_sensor_i2c_4_hw_mtk = "/fragment@59/__overlay__/ccu_sensor_i2c_4_hw@11";
		subpmic_pmu_mtk = "/fragment@60/__overlay__/subpmic_pmu@34";
		usb_type_c_mtk = "/fragment@60/__overlay__/usb_type_c@4e";
		usb_type_c_sgm_mtk = "/fragment@60/__overlay__/usb_type_c_sgm@47";
		camera_main_two_eeprom_mtk = "/fragment@61/__overlay__/camera_main_two_eeprom@50";
		camera_main_two_af_mtk = "/fragment@61/__overlay__/camera_main_two_af@0c";
		ext_buck_vgpu_mtk = "/fragment@61/__overlay__/ext_buck_vgpu@55";
	};

	__fixups__ {
		odm = "/fragment@0:target:0\0/fragment@15:target:0\0/fragment@48:target:0";
		lk_charger = "/fragment@1:target:0";
		i2c6 = "/fragment@2:target:0\0/fragment@14:target:0\0/fragment@22:target:0\0/fragment@61:target:0";
		mt_pmic_vio28_ldo_reg = "/fragment@2/__overlay__/abov_sar@20:cap_vdd-supply:0\0/fragment@22/__overlay__/abov_sar@20:cap_vdd-supply:0";
		pio = "/fragment@2/__overlay__/abov_sar@20:interrupt-parent:0\0/fragment@2/__overlay__/abov_sar@20:abov,irq-gpio-std:0\0/fragment@3:target:0\0/fragment@5:target:0\0/fragment@9:target:0\0/fragment@10/__overlay__/touch@0:novatek,reset-gpio:0\0/fragment@10/__overlay__/touch@0:novatek,irq-gpio:0\0/fragment@17:target:0\0/fragment@22/__overlay__/abov_sar@20:interrupt-parent:0\0/fragment@22/__overlay__/abov_sar@20:abov,irq-gpio-std:0\0/fragment@23:target:0\0/fragment@26:target:0\0/fragment@29:target:0\0/fragment@36/__overlay__:interrupt-parent:0\0/fragment@36/__overlay__:deb-gpios:0\0/fragment@37/__overlay__:hacpa-gpio:0\0/fragment@38:target:0\0/fragment@39/__overlay__:mt6370,intr_gpio:0\0/fragment@41/__overlay__:mt6370pd,intr_gpio:0\0/fragment@47:target:0\0/fragment@48/__overlay__/fingerprint_int:interrupt-parent:0\0/fragment@48/__overlay__/fingerprint_int:fpc,vdd:0\0/fragment@48/__overlay__/fingerprint_int:fpc,rst:0\0/fragment@48/__overlay__/fingerprint_int:fpc,irq:0\0/fragment@48/__overlay__/goodix_int:interrupt-parent:0\0/fragment@48/__overlay__/goodix_int:int-gpios:0\0/fragment@51/__overlay__:sgm7220,intr_gpio:0\0/fragment@51/__overlay__:sgm7220,en_gpio:0\0/fragment@65/__overlay__:GPIO_SIM2_SIO:0\0/fragment@65/__overlay__:GPIO_SIM2_SRST:0\0/fragment@65/__overlay__:GPIO_SIM2_SCLK:0\0/fragment@65/__overlay__:GPIO_SIM1_SCLK:0\0/fragment@65/__overlay__:GPIO_SIM1_SRST:0\0/fragment@65/__overlay__:GPIO_SIM1_SIO:0\0/fragment@65/__overlay__:GPIO_SIM1_HOT_PLUG:0\0/fragment@67/__overlay__:interrupt-parent:0\0/fragment@68/__overlay__:interrupt-parent:0\0/fragment@69/__overlay__:interrupt-parent:0\0/fragment@69/__overlay__:deb-gpios:0\0/fragment@70/__overlay__:interrupt-parent:0\0/fragment@71/__overlay__:interrupt-parent:0\0/fragment@72/__overlay__:interrupt-parent:0\0/fragment@73/__overlay__:interrupt-parent:0\0/fragment@74/__overlay__:interrupt-parent:0\0/fragment@75/__overlay__:interrupt-parent:0\0/fragment@75/__overlay__:deb-gpios:0\0/fragment@76/__overlay__:interrupt-parent:0";
		kd_camera_hw1 = "/fragment@4:target:0\0/fragment@30:target:0\0/fragment@84:target:0";
		mt_pmic_vcamio_ldo_reg = "/fragment@4/__overlay__:cam0_vcamio-supply:0\0/fragment@4/__overlay__:cam1_vcamio-supply:0\0/fragment@4/__overlay__:cam2_vcamio-supply:0\0/fragment@82:target:0\0/fragment@84/__overlay__:vcamio-supply:0\0/fragment@84/__overlay__:vcamio_sub-supply:0\0/fragment@84/__overlay__:vcamio_main2-supply:0";
		mt_pmic_vcamd_ldo_reg = "/fragment@4/__overlay__:cam0_vcamd-supply:0\0/fragment@4/__overlay__:cam1_vcamd-supply:0\0/fragment@81:target:0\0/fragment@84/__overlay__:vcamd_main2-supply:0";
		mt_pmic_vcama_ldo_reg = "/fragment@4/__overlay__:cam2_vcama-supply:0\0/fragment@78:target:0";
		flashlights_ocp8132 = "/fragment@6:target:0";
		camera_af_hw_node = "/fragment@7:target:0";
		mt_pmic_vldo28_ldo_reg = "/fragment@7/__overlay__:camaf_m1_pmic-supply:0\0/fragment@83:target:0\0/fragment@84/__overlay__:vcamaf-supply:0\0/fragment@84/__overlay__:vcamaf_sub-supply:0\0/fragment@84/__overlay__:vcamaf_main2-supply:0";
		touch = "/fragment@8:target:0\0/fragment@27:target:0\0/fragment@70:target:0\0/fragment@85:target:0";
		spi3 = "/fragment@10:target:0";
		reserved_memory = "/fragment@11:target:0";
		chosen = "/fragment@12:target:0\0/fragment@33/__overlay__:bootmode:0";
		i2c5 = "/fragment@13:target:0\0/fragment@60:target:0";
		regulator_vibrator = "/fragment@16:target:0";
		mtkfb = "/fragment@18:target:0";
		i2c2 = "/fragment@19:target:0\0/fragment@57:target:0";
		i2c0 = "/fragment@20:target:0\0/fragment@55:target:0";
		i2c3 = "/fragment@21:target:0\0/fragment@58:target:0";
		consys = "/fragment@24:target:0";
		keypad = "/fragment@25:target:0\0/fragment@86:target:0";
		accdet = "/fragment@28:target:0\0/fragment@67:target:0";
		moto_chg_tcmd = "/fragment@31:target:0";
		msdc1 = "/fragment@32:target:0";
		mtk_charger_type = "/fragment@33:target:0\0/fragment@34/__overlay__:charger:0\0/fragment@35/__overlay__:charger:0\0/fragment@40/__overlay__:charger:0\0/fragment@50/__overlay__:charger:0";
		mtk_gauge = "/fragment@34:target:0";
		usb = "/fragment@35:target:0";
		key_google = "/fragment@36:target:0";
		audgpio = "/fragment@37:target:0";
		mt6370_pmu = "/fragment@39:target:0";
		charger = "/fragment@40:target:0";
		mt6370_typec = "/fragment@41:target:0";
		mt6370_chg = "/fragment@42:target:0";
		pe = "/fragment@43:target:0";
		pe2 = "/fragment@44:target:0";
		pe4 = "/fragment@45:target:0";
		pdc = "/fragment@46:target:0";
		spi1 = "/fragment@49:target:0";
		rt1711_typec = "/fragment@50:target:0";
		sgm7220_typec = "/fragment@51:target:0";
		auxadc = "/fragment@52:target:0\0/fragment@53/__overlay__:io-channels:0";
		md_auxadc = "/fragment@53:target:0";
		pmic_clock_buffer_ctrl = "/fragment@54:target:0";
		i2c1 = "/fragment@56:target:0";
		i2c4 = "/fragment@59:target:0";
		i2c7 = "/fragment@62:target:0";
		i2c8 = "/fragment@63:target:0";
		i2c9 = "/fragment@64:target:0";
		gpio_usage_mapping = "/fragment@65:target:0";
		gpio = "/fragment@66:target:0";
		msdc1_ins = "/fragment@68:target:0";
		mrdump_ext_rst = "/fragment@69:target:0";
		subpmic_pmu_eint = "/fragment@71:target:0";
		goodix_fp = "/fragment@72:target:0";
		tcpc_pd = "/fragment@73:target:0";
		dsi_te = "/fragment@74:target:0";
		swtp = "/fragment@75:target:0";
		main_pmic = "/fragment@76:target:0";
		md1_sim1_hot_plug_eint = "/fragment@77:target:0";
		mt_pmic_vsim1_ldo_reg = "/fragment@79:target:0";
		mt_pmic_vsim2_ldo_reg = "/fragment@80:target:0";
	};

	__local_fixups__ {

		fragment@4 {

			__overlay__ {
				pinctrl-0 = <0x00>;
				pinctrl-1 = <0x00>;
				pinctrl-2 = <0x00>;
				pinctrl-3 = <0x00>;
				pinctrl-4 = <0x00>;
				pinctrl-5 = <0x00>;
				pinctrl-6 = <0x00>;
				pinctrl-7 = <0x00>;
				pinctrl-8 = <0x00>;
				pinctrl-9 = <0x00>;
				pinctrl-10 = <0x00>;
				pinctrl-11 = <0x00>;
				pinctrl-12 = <0x00>;
				pinctrl-13 = <0x00>;
				pinctrl-14 = <0x00>;
				pinctrl-15 = <0x00>;
				pinctrl-16 = <0x00>;
				pinctrl-17 = <0x00>;
				pinctrl-18 = <0x00>;
				pinctrl-19 = <0x00>;
				pinctrl-20 = <0x00>;
				pinctrl-21 = <0x00>;
				pinctrl-22 = <0x00>;
				pinctrl-23 = <0x00>;
				pinctrl-24 = <0x00>;
			};
		};

		fragment@6 {

			__overlay__ {
				pinctrl-0 = <0x00>;
				pinctrl-1 = <0x00>;
				pinctrl-2 = <0x00>;
				pinctrl-3 = <0x00>;
				pinctrl-4 = <0x00>;
			};
		};

		fragment@8 {

			__overlay__ {
				pinctrl-0 = <0x00>;
				pinctrl-1 = <0x00>;
				pinctrl-2 = <0x00>;
				pinctrl-3 = <0x00>;
				pinctrl-4 = <0x00>;
				pinctrl-5 = <0x00>;
			};
		};

		fragment@18 {

			__overlay__ {
				pinctrl-0 = <0x00>;
				pinctrl-1 = <0x00>;
				pinctrl-2 = <0x00>;
				pinctrl-3 = <0x00>;
				pinctrl-4 = <0x00>;
				pinctrl-5 = <0x00>;
				pinctrl-6 = <0x00>;
				pinctrl-7 = <0x00>;
				pinctrl-8 = <0x00>;
			};
		};

		fragment@24 {

			__overlay__ {
				pinctrl-0 = <0x00>;
				pinctrl-1 = <0x00>;
				pinctrl-2 = <0x00>;
				pinctrl-3 = <0x00>;
			};
		};

		fragment@25 {

			__overlay__ {
				pinctrl-0 = <0x00>;
			};
		};

		fragment@28 {

			__overlay__ {
				pinctrl-0 = <0x00>;
				pinctrl-1 = <0x00>;
			};
		};

		fragment@34 {

			__overlay__ {
				extern_charger = <0x00>;
				extern_charger_3rd = <0x00>;
			};
		};

		fragment@37 {

			__overlay__ {
				pinctrl-0 = <0x00>;
				pinctrl-1 = <0x00>;
				pinctrl-2 = <0x00>;
				pinctrl-3 = <0x00>;
				pinctrl-4 = <0x00>;
				pinctrl-5 = <0x00>;
				pinctrl-6 = <0x00>;
				pinctrl-7 = <0x00>;
				pinctrl-8 = <0x00>;
				pinctrl-9 = <0x00>;
				pinctrl-10 = <0x00>;
				pinctrl-11 = <0x00>;
			};
		};

		fragment@48 {

			__overlay__ {

				fingerprint_int {
					pinctrl-0 = <0x00>;
					pinctrl-1 = <0x00>;
					pinctrl-2 = <0x00>;
				};

				goodix_int {
					pinctrl-0 = <0x00>;
					pinctrl-1 = <0x00>;
					pinctrl-2 = <0x00>;
				};
			};
		};
	};
};
